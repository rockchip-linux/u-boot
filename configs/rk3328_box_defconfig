## configs/rk3328_box_defconfig
```kconfig
CONFIG_SYS_EXTRA_OPTIONS="RKCHIP_RK3328,RKCHIP_RK322XH,PRODUCT_BOX,NORMAL_WORLD,SECOND_LEVEL_BOOTLOADER,BAUDRATE=1500000"
CONFIG_ARM=y
CONFIG_ROCKCHIP_ARCH64=y
CONFIG_PLAT_RK33XX=y
# CONFIG_SYS_MALLOC_CLEAR_ON_INIT is not set
```

## configs/rk3366-fpga_defconfig
```kconfig
CONFIG_SYS_EXTRA_OPTIONS="RKCHIP_RK3366,PRODUCT_MID,FPGA_BOARD,SECOND_LEVEL_BOOTLOADER"
CONFIG_ARM=y
CONFIG_ROCKCHIP_ARCH64=y
CONFIG_PLAT_RK33XX=y
```

## configs/rk3366_defconfig
```kconfig
CONFIG_SYS_EXTRA_OPTIONS="RKCHIP_RK3366,PRODUCT_MID,BAUDRATE=1500000,SECOND_LEVEL_BOOTLOADER"
CONFIG_ARM=y
CONFIG_GICV2=y
CONFIG_ROCKCHIP_ARCH64=y
CONFIG_PLAT_RK33XX=y
```

## configs/rk3368-fpga_defconfig
```kconfig
CONFIG_SYS_EXTRA_OPTIONS="RKCHIP_RK3368,FPGA_BOARD"
CONFIG_ARM=y
CONFIG_ROCKCHIP_ARCH64=y
CONFIG_PLAT_RK33XX=y
```

## configs/rk3368_box_defconfig
```kconfig
CONFIG_SYS_EXTRA_OPTIONS="RKCHIP_RK3368,PRODUCT_BOX,SECOND_LEVEL_BOOTLOADER"
CONFIG_ARM=y
CONFIG_ROCKCHIP_ARCH64=y
CONFIG_PLAT_RK33XX=y
```

## configs/rk3368h_defconfig
```kconfig
CONFIG_SYS_EXTRA_OPTIONS="RKCHIP_RK3368H,RKCHIP_RK3368,PRODUCT_MID,NORMAL_WORLD,SECOND_LEVEL_BOOTLOADER"
CONFIG_ARM=y
CONFIG_ROCKCHIP_ARCH64=y
CONFIG_PLAT_RK33XX=y
# CONFIG_SYS_MALLOC_CLEAR_ON_INIT is not set
```

## configs/rk3399-fpga_defconfig
```kconfig
CONFIG_SYS_EXTRA_OPTIONS="RKCHIP_RK3399,FPGA_BOARD,SECOND_LEVEL_BOOTLOADER"
CONFIG_ARM=y
CONFIG_ROCKCHIP_ARCH64=y
CONFIG_PLAT_RK33XX=y
```

## configs/rk3399_box_defconfig
```kconfig
CONFIG_SYS_EXTRA_OPTIONS="RKCHIP_RK3399,PRODUCT_BOX,BAUDRATE=1500000,SECOND_LEVEL_BOOTLOADER"
CONFIG_ARM=y
CONFIG_ROCKCHIP_ARCH64=y
CONFIG_PLAT_RK33XX=y
```

## configs/rk3399pro_defconfig
```kconfig
CONFIG_SYS_EXTRA_OPTIONS="RKCHIP_RK3399,RKCHIP_RK3399PRO,PRODUCT_MID,NORMAL_WORLD,SECOND_LEVEL_BOOTLOADER,BAUDRATE=1500000"
CONFIG_ARM=y
CONFIG_ROCKCHIP_ARCH64=y
CONFIG_PLAT_RK33XX=y
```

## configs/rock64-rk3328_defconfig
```kconfig
CONFIG_ARM=y
CONFIG_ARCH_ROCKCHIP=y
CONFIG_SPL_LIBCOMMON_SUPPORT=y
CONFIG_SPL_LIBGENERIC_SUPPORT=y
CONFIG_SYS_MALLOC_F_LEN=0x2000
CONFIG_ROCKCHIP_RK3328=y
CONFIG_TPL_LDSCRIPT="arch/arm/mach-rockchip/rk3328/u-boot-tpl.lds"
CONFIG_ROCKCHIP_SPL_RESERVE_IRAM=0x0
CONFIG_TPL_LIBCOMMON_SUPPORT=y
CONFIG_TPL_LIBGENERIC_SUPPORT=y
CONFIG_SPL_DRIVERS_MISC_SUPPORT=y
CONFIG_TARGET_ROCK64_RK3328=y
CONFIG_SPL_SPI_FLASH_SUPPORT=y
CONFIG_SPL_SPI_SUPPORT=y
CONFIG_SPL_STACK_R_ADDR=0x600000
CONFIG_DEFAULT_DEVICE_TREE="rk3328-rock64"
CONFIG_DEBUG_UART=y
CONFIG_TPL_SYS_MALLOC_F_LEN=0x800
# CONFIG_ANDROID_BOOT_IMAGE is not set
CONFIG_FIT=y
CONFIG_FIT_VERBOSE=y
CONFIG_SPL_LOAD_FIT=y
CONFIG_SPL_FIT_GENERATOR="board/rockchip/evb_rk3328/mk_fit_atf.sh"
CONFIG_BOOTDELAY=0
# CONFIG_DISPLAY_CPUINFO is not set
CONFIG_SPL_BOOTROM_SUPPORT=y
CONFIG_TPL_SYS_MALLOC_SIMPLE=y
CONFIG_SPL_STACK_R=y
CONFIG_SYS_MMCSD_RAW_MODE_U_BOOT_SECTOR=0x200
CONFIG_SPL_MTD_SUPPORT=y
CONFIG_SPL_ATF_SUPPORT=y
CONFIG_TPL_BOOTROM_SUPPORT=y
CONFIG_TPL_DRIVERS_MISC_SUPPORT=y
CONFIG_FASTBOOT_BUF_ADDR=0x00800800
CONFIG_FASTBOOT_BUF_SIZE=0x08000000
CONFIG_FASTBOOT_FLASH=y
CONFIG_FASTBOOT_FLASH_MMC_DEV=1
CONFIG_CMD_BOOTZ=y
# CONFIG_CMD_IMLS is not set
CONFIG_CMD_MEMINFO=y
CONFIG_CMD_MEMTEST=y
CONFIG_CMD_SHA1SUM=y
CONFIG_CMD_GPIO=y
CONFIG_CMD_GPT=y
CONFIG_CMD_I2C=y
CONFIG_CMD_MMC=y
CONFIG_CMD_SF=y
CONFIG_CMD_SPI=y
CONFIG_CMD_USB=y
CONFIG_CMD_USB_MASS_STORAGE=y
# CONFIG_CMD_SETEXPR is not set
CONFIG_CMD_ETHSW=y
CONFIG_CMD_TIME=y
CONFIG_CMD_REGULATOR=y
CONFIG_CMD_MTDPARTS=y
# CONFIG_SPL_DOS_PARTITION is not set
# CONFIG_SPL_ISO_PARTITION is not set
# CONFIG_SPL_EFI_PARTITION is not set
CONFIG_SPL_OF_CONTROL=y
CONFIG_TPL_OF_CONTROL=y
CONFIG_OF_SPL_REMOVE_PROPS="pinctrl-0 pinctrl-names clock-names interrupt-parent assigned-clocks assigned-clock-rates assigned-clock-parents"
CONFIG_TPL_OF_PLATDATA=y
CONFIG_ENV_IS_IN_SPI_FLASH=y
CONFIG_NET_RANDOM_ETHADDR=y
CONFIG_TPL_DM=y
CONFIG_SPL_DM_SEQ_ALIAS=y
CONFIG_REGMAP=y
CONFIG_SPL_REGMAP=y
CONFIG_TPL_REGMAP=y
CONFIG_SYSCON=y
CONFIG_SPL_SYSCON=y
CONFIG_TPL_SYSCON=y
CONFIG_CLK=y
CONFIG_SPL_CLK=y
CONFIG_TPL_CLK=y
CONFIG_ROCKCHIP_GPIO=y
CONFIG_SYS_I2C_ROCKCHIP=y
CONFIG_DM_KEY=y
CONFIG_LED=y
CONFIG_MISC=y
CONFIG_ROCKCHIP_EFUSE=y
CONFIG_MMC_DW=y
CONFIG_MMC_DW_ROCKCHIP=y
CONFIG_MTD=y
CONFIG_SPI_FLASH=y
CONFIG_SPI_FLASH_GIGADEVICE=y
CONFIG_SPI_FLASH_WINBOND=y
CONFIG_PHY_REALTEK=y
CONFIG_DM_ETH=y
CONFIG_ETH_DESIGNWARE=y
CONFIG_GMAC_ROCKCHIP=y
CONFIG_PHY=y
CONFIG_PHY_ROCKCHIP_INNO_USB2=y
CONFIG_PINCTRL=y
CONFIG_SPL_PINCTRL=y
CONFIG_PINCTRL_ROCKCHIP_RK3328=y
CONFIG_DM_PMIC=y
# CONFIG_SPL_PMIC_CHILDREN is not set
CONFIG_PMIC_RK8XX=y
CONFIG_REGULATOR_PWM=y
CONFIG_DM_REGULATOR_FIXED=y
CONFIG_REGULATOR_RK8XX=y
CONFIG_RAM=y
CONFIG_SPL_RAM=y
CONFIG_TPL_RAM=y
CONFIG_DM_RESET=y
CONFIG_BAUDRATE=1500000
CONFIG_DEBUG_UART_BASE=0xFF130000
CONFIG_DEBUG_UART_CLOCK=24000000
CONFIG_DEBUG_UART_SHIFT=2
CONFIG_DEBUG_UART_ANNOUNCE=y
CONFIG_DEBUG_UART_SKIP_INIT=y
CONFIG_ROCKCHIP_SPI=y
CONFIG_SYSRESET=y
CONFIG_USB=y
CONFIG_USB_XHCI_HCD=y
CONFIG_USB_XHCI_DWC3=y
CONFIG_USB_EHCI_HCD=y
CONFIG_USB_EHCI_GENERIC=y
CONFIG_USB_OHCI_HCD=y
CONFIG_USB_OHCI_GENERIC=y
CONFIG_USB_DWC2=y
CONFIG_USB_STORAGE=y
CONFIG_USB_GADGET=y
CONFIG_USB_GADGET_DWC2_OTG=y
CONFIG_USB_GADGET_DOWNLOAD=y
CONFIG_G_DNL_MANUFACTURER="Rockchip"
CONFIG_G_DNL_VENDOR_NUM=0x2207
CONFIG_G_DNL_PRODUCT_NUM=0x330a
CONFIG_USE_TINY_PRINTF=y
CONFIG_SPL_TINY_MEMSET=y
CONFIG_ERRNO_STR=y
```

## configs/rockpi4b-rk3399_defconfig
```kconfig
CONFIG_ARM=y
CONFIG_ARCH_ROCKCHIP=y
CONFIG_SPL_LIBCOMMON_SUPPORT=y
CONFIG_SPL_LIBGENERIC_SUPPORT=y
CONFIG_SYS_MALLOC_F_LEN=0x4000
CONFIG_ROCKCHIP_RK3399=y
CONFIG_ROCKCHIP_SPL_RESERVE_IRAM=0x0
CONFIG_TARGET_ROCKPRO64_RK3399=y
CONFIG_SPL_SPI_FLASH_SUPPORT=y
CONFIG_SPL_SPI_SUPPORT=y
CONFIG_SPL_STACK_R_ADDR=0x600000
CONFIG_DEFAULT_DEVICE_TREE="rk3399-rockpi4b"
CONFIG_DEBUG_UART=y
CONFIG_FIT=y
CONFIG_SPL_LOAD_FIT=y
CONFIG_SPL_FIT_GENERATOR="board/rockchip/rockpro64_rk3399/mk_fit_atf.sh"
CONFIG_BOOTDELAY=2
# CONFIG_DISPLAY_CPUINFO is not set
CONFIG_ANDROID_BOOTLOADER=y
CONFIG_SPL_BOOTROM_SUPPORT=y
CONFIG_SPL_STACK_R=y
CONFIG_SPL_STACK_R_MALLOC_SIMPLE_LEN=0x4000
CONFIG_SYS_MMCSD_RAW_MODE_U_BOOT_SECTOR=0x200
CONFIG_SPL_MTD_SUPPORT=y
CONFIG_SPL_ATF_SUPPORT=y
CONFIG_FASTBOOT_BUF_ADDR=0x00800800
CONFIG_FASTBOOT_BUF_SIZE=0x08000000
CONFIG_FASTBOOT_FLASH=y
CONFIG_FASTBOOT_FLASH_MMC_DEV=0
CONFIG_CMD_BOOTZ=y
# CONFIG_CMD_IMLS is not set
CONFIG_CMD_MEMINFO=y
CONFIG_CMD_SHA1SUM=y
CONFIG_SHA1SUM_VERIFY=y
CONFIG_CMD_GPIO=y
CONFIG_CMD_GPT=y
CONFIG_CMD_LOAD_ANDROID=y
CONFIG_CMD_BOOT_ANDROID=y
CONFIG_CMD_MMC=y
CONFIG_CMD_SF=y
CONFIG_CMD_USB=y
CONFIG_CMD_USB_MASS_STORAGE=y
# CONFIG_CMD_SETEXPR is not set
CONFIG_CMD_TIME=y
CONFIG_CMD_REGULATOR=y
CONFIG_CMD_MTDPARTS=y
CONFIG_SPL_OF_CONTROL=y
CONFIG_OF_SPL_REMOVE_PROPS="pinctrl-0 pinctrl-names clock-names interrupt-parent assigned-clocks assigned-clock-rates assigned-clock-parents"
CONFIG_ENV_IS_IN_SPI_FLASH=y
CONFIG_SPL_DM_SEQ_ALIAS=y
CONFIG_REGMAP=y
CONFIG_SPL_REGMAP=y
CONFIG_SYSCON=y
CONFIG_SPL_SYSCON=y
CONFIG_CLK=y
CONFIG_SPL_CLK=y
CONFIG_ROCKCHIP_GPIO=y
CONFIG_SYS_I2C_ROCKCHIP=y
CONFIG_LED=y
CONFIG_LED_GPIO=y
CONFIG_MISC=y
CONFIG_ROCKCHIP_EFUSE=y
CONFIG_MMC_DW=y
CONFIG_MMC_DW_ROCKCHIP=y
CONFIG_MMC_SDHCI=y
CONFIG_MMC_SDHCI_ROCKCHIP=y
CONFIG_SPI_FLASH=y
CONFIG_SPI_FLASH_GIGADEVICE=y
CONFIG_SPI_FLASH_WINBOND=y
CONFIG_DM_ETH=y
CONFIG_ETH_DESIGNWARE=y
CONFIG_GMAC_ROCKCHIP=y
CONFIG_PINCTRL=y
CONFIG_SPL_PINCTRL=y
CONFIG_PINCTRL_ROCKCHIP_RK3399=y
CONFIG_DM_PMIC=y
CONFIG_PMIC_RK8XX=y
CONFIG_REGULATOR_PWM=y
CONFIG_DM_REGULATOR_FIXED=y
CONFIG_REGULATOR_RK8XX=y
CONFIG_PWM_ROCKCHIP=y
CONFIG_RAM=y
CONFIG_SPL_RAM=y
CONFIG_DM_RESET=y
CONFIG_BAUDRATE=1500000
CONFIG_DEBUG_UART_BASE=0xFF1A0000
CONFIG_DEBUG_UART_CLOCK=24000000
CONFIG_DEBUG_UART_SHIFT=2
CONFIG_SYS_NS16550=y
CONFIG_ROCKCHIP_SPI=y
CONFIG_SYSRESET=y
CONFIG_USB=y
CONFIG_USB_XHCI_HCD=y
CONFIG_USB_XHCI_DWC3=y
CONFIG_USB_EHCI_HCD=y
CONFIG_USB_EHCI_GENERIC=y
CONFIG_USB_DWC3=y
CONFIG_USB_DWC3_GADGET=y
CONFIG_USB_STORAGE=y
CONFIG_USB_GADGET=y
CONFIG_USB_GADGET_DOWNLOAD=y
CONFIG_G_DNL_MANUFACTURER="Rockchip"
CONFIG_G_DNL_VENDOR_NUM=0x18d1
CONFIG_G_DNL_PRODUCT_NUM=0xd00d
CONFIG_USB_HOST_ETHER=y
CONFIG_USB_ETHER_ASIX=y
CONFIG_USB_ETHER_ASIX88179=y
CONFIG_USB_ETHER_MCS7830=y
CONFIG_USB_ETHER_RTL8152=y
CONFIG_USB_ETHER_SMSC95XX=y
CONFIG_USE_TINY_PRINTF=y
CONFIG_ERRNO_STR=y
```

## drivers/keylad/Kconfig
```kconfig
menu "Keylad devices"

config SPL_DM_KEYLAD
	bool "Enable Driver Model for KEYLAD drivers in spl"
	depends on SPL_DM
	---help---
	This config enables the dm keylad support.

endmenu
```

## drivers/video/drm/Kconfig
```kconfig
menuconfig DRM_ROCKCHIP
	bool "Rockchip DRM Support"
	depends on DM_VIDEO && OF_LIVE
	select VIDEO_BRIDGE
	select PHY
	help
	  Rockchip SoCs provide video output capabilities for High-Definition
	  Multimedia Interface (HDMI), Low-voltage Differential Signalling
	  (LVDS), embedded DisplayPort (eDP) and Display Serial Interface (DSI).

	  This driver supports the on-chip video output device, and targets the
	  Rockchip RK3288 and RK3399.

config DRM_ROCKCHIP_PANEL
	bool "Rockchip Panel Support"
	depends on DRM_ROCKCHIP
	select DRM_MIPI_DSI

config DRM_ROCKCHIP_DW_HDMI
	bool "Rockchip specific extensions for Synopsys DW HDMI"
	depends on DRM_ROCKCHIP
	help
	 This selects support for Rockchip SoC specific extensions
	 for the Synopsys DesignWare HDMI driver. If you want to
	 enable HDMI on, you should selet this option.

config ROCKCHIP_INNO_HDMI_PHY
	bool "Rockchip specific extensions for INNO HDMI PHY"
	depends on DRM_ROCKCHIP
	help
	 This selects support for INNO HDMI PHY. If you want to
	 use HDMI or TVE in RK322XH or RK322X, you should selet
	 this option.

config DRM_ROCKCHIP_INNO_MIPI_PHY
	tristate "Rockchip INNO MIPI PHY driver"
	depends on DRM_ROCKCHIP
	help
	  Enable this to support the Rockchip MIPI PHY
	  with Innosilicon IP block.

config DRM_ROCKCHIP_INNO_VIDEO_PHY
	tristate "Rockchip INNO LVDS/TTL PHY driver"
	depends on DRM_ROCKCHIP
	help
	  Enable this to support the Rockchip LVDS/TTL PHY
	  with Innosilicon IP block.

config DRM_ROCKCHIP_INNO_VIDEO_COMBO_PHY
	tristate "Rockchip INNO MIPI/LVDS/TTL PHY driver"
	depends on DRM_ROCKCHIP
	help
	  Enable this to support the Rockchip MIPI/LVDS/TTL PHY
	  with Innosilicon IP block.

config DRM_MIPI_DSI
	bool
	depends on DRM_ROCKCHIP

config DRM_ROCKCHIP_DW_MIPI_DSI
	tristate "Rockchip specific extensions for Synopsys DW MIPI DSI"
	depends on DRM_ROCKCHIP
	select DRM_MIPI_DSI
	select DRM_ROCKCHIP_PANEL
	help
	 This selects support for Rockchip SoC specific extensions
	 for the Synopsys DesignWare HDMI driver. If you want to
	 enable MIPI DSI on RK3288 based SoC, you should selet this
	 option.

config DRM_ROCKCHIP_ANALOGIX_DP
	bool "Rockchip specific extensions for Analogix DP driver"
	depends on DRM_ROCKCHIP
	select DRM_ROCKCHIP_PANEL
	help
	  This selects support for Rockchip SoC specific extensions
	  for the Analogix Core DP driver. If you want to enable DP
	  on RK3288 based SoC, you should selet this option.

config DRM_ROCKCHIP_LVDS
	bool "Rockchip LVDS Support"
	depends on DRM_ROCKCHIP
	select DRM_ROCKCHIP_PANEL
	help
	  Choose this option to enable support for Rockchip LVDS controllers.
	  Rockchip rk3288 SoC has LVDS TX Controller can be used, and it
	  support LVDS, rgb, dual LVDS output mode. say Y to enable its
	  driver.

config DRM_ROCKCHIP_RGB
	bool "Rockchip RGB Support"
	depends on DRM_ROCKCHIP
	select DRM_ROCKCHIP_PANEL
	help
	  Choose this option to enable support for Rockchip RGB driver.
	  say Y to enable its driver.

config DRM_ROCKCHIP_RK618
	bool "Rockchip RK618 display bridge driver"
	depends on DRM_ROCKCHIP
	select DRM_ROCKCHIP_PANEL
	select VIDEO_BRIDGE
	help
	  Choose this option to enable support for Rockchip RK618 display
	  bridge chips driver. say Y to enable its driver.

config DRM_ROCKCHIP_RK1000
	bool "Rockchip RK1000 display bridge driver"
	depends on DRM_ROCKCHIP
	select DRM_ROCKCHIP_PANEL
	select VIDEO_BRIDGE
	help
	  Choose this option to enable support for Rockchip RK1000 display
	  bridge chips driver. say Y to enable its driver.

config ROCKCHIP_DRM_TVE
	bool "Rockchip TVE Support"
	depends on DRM_ROCKCHIP
	help
	  Choose this option to enable support for Rockchip TVE.
	  Rockchip rk322x and rk322xh SoC has TVE can be used, and
	  say Y to enable TVE driver.
```

## drivers/video/rk_ebook/Kconfig
```kconfig
config ROCKCHIP_EBC_TCON
        bool "Rockchip ebc tcon Support"
        depends on ROCKCHIP_EBOOK
        help
           Choose this option to enable support for EBC TCON controller

config ROCKCHIP_TPS65185
        bool "TPS65185 Support"
        depends on ROCKCHIP_EBOOK
        help
           Choose this option to enable support for TPS65185, which is
           used to supply power for ebook panel.

config ROCKCHIP_EBOOK_DISPLAY
        bool "Rockchip EBOOK DISPLAY Support"
        depends on ROCKCHIP_EBOOK
        help
           Choose this option to enable support for ebook display, which is
           used to display uboot/charging/lowerpower logo, and also used to
           load kernel logo to ram, which can pass to kernel to display.

config ROCKCHIP_EBC_PMIC_FP9931
        bool "FP9931 PMIC Suppot"
        depends on ROCKCHIP_EBOOK
        depends on REGULATOR_FP9931
        depends on FP9931_THERMAL
        help
          Choose this option to enable support for FP9931 PMIC.

config ROCKCHIP_EBC_PMIC_SY7636A
        bool "SY7636A PMIC Suppot"
        depends on ROCKCHIP_EBOOK
        depends on REGULATOR_SY7636A
        depends on SY7636A_THERMAL
        help
          Choose this option to enable support for SY7636A PMIC.
```

## lib/optee_clientApi/Kconfig
```kconfig
config OPTEE_CLIENT
	bool "Support OPTEE"
	help
	  U-boot can communicate with trust if
	  the config is enable. This function can
	  be use in android bootloader a/b and avb
	  step.
```
