// SPDX-License-Identifier: (GPL-2.0+ OR MIT)
/*
 * Copyright (c) 2025 Rockchip Electronics Co., Ltd.
 */

/dts-v1/;

#include <dt-bindings/input/input.h>
#include "rk3538.dtsi"

/ {
	model = "Rockchip RK3538 EVB board";
	compatible = "rockchip,rk3538-evb", "rockchip,rk3538";

	adc-keys-1 {
		compatible = "adc-keys";
		io-channels = <&saradc 1>;
		io-channel-names = "buttons";
		keyup-threshold-microvolt = <1800000>;
		poll-interval = <100>;
		bootph-all;

		button-recovery {
			bootph-all;
			label = "Recovery";
			linux,code = <KEY_VOLUMEUP>;
			press-threshold-microvolt = <17000>;
		};
	};
};

&uart0 {
	clocks = <&xin24m>, <&xin24m>;
};
