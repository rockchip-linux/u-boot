## drivers/tee/optee/Kconfig
```kconfig
# OP-TEE Trusted Execution Environment Configuration
config OPTEE
	bool "OP-TEE"
	depends on ARM_SMCCC
	help
	  This implements the OP-TEE Trusted Execution Environment (TEE)
	  driver. OP-TEE is a Trusted OS designed primarily to rely on the
	  ARM TrustZone(R) technology as the underlying hardware isolation
	  mechanism. This driver can request services from OP-TEE, but also
	  handle Remote Procedure Calls (RPC) from OP-TEE needed to
	  execute a service. For more information see: https://www.op-tee.org

config ROCKCHIP_OPTEE_V2
	bool "Support rockchip OPTEE version 2.0"
	depends on OPTEE
	help
	  U-boot can communicate with OPTEE if the config is enable.
	  This function can be use in android bootloader a/b and avb step.
	  Support platform:
	  rk3326 px30 rk3358 rk3308 rk1808 rv1109 rv1126 rk3566 rk3568
	  rk3588 rk3528 rk3562 rv1106 rk3576 rv1103b rv1106 rv1126b rk3506.

config ROCKCHIP_OPTEE_V3
	bool "Support rockchip OPTEE version 3.0"
	depends on OPTEE
	help
	  U-boot can communicate with OPTEE if the config is enable.
	  This function can be use in android bootloader a/b and avb step.
	  Support platform:
	  rk3572 rk3538 and new platforms in the future.

if OPTEE || SANDBOX

menu "OP-TEE options"

config OPTEE_TA_AVB
	bool "Support AVB TA"
	default y
	help
	  Enables support for the AVB Trusted Application (TA) in OP-TEE.
	  The TA can support the "avb" subcommands "read_rb", "write_rb"
	  and "is_unlocked".

config OPTEE_TA_RPC_TEST
	bool "Support RPC TEST TA"
	depends on SANDBOX_TEE
	default y
	help
	  Enables support for RPC test trusted application emulation, which
	  permits to test reverse RPC calls to TEE supplicant. Should
	  be used only in sandbox env.

config OPTEE_TA_SCP03
	bool "Support SCP03 TA"
	default y
	help
	  Enables support for controlling (enabling, provisioning) the
	  Secure Channel Protocol 03 operation in the OP-TEE SCP03 TA.

config OPTEE_SERVICE_DISCOVERY
	bool "OP-TEE service discovery"
	default y
	help
	  This implements automated driver binding of OP-TEE service drivers by
	  requesting OP-TEE firmware to enumerate its hosted services.

endmenu

endif
```

## drivers/ufs/Kconfig
```kconfig
menu "UFS Host Controller Support"

config UFS
	bool "Support UFS controllers"
	depends on SCSI
	select CHARSET
	help
	  This selects support for Universal Flash Subsystem (UFS).
	  Say Y here if you want UFS Support.

config CADENCE_UFS
	bool "Cadence platform driver for UFS"
	depends on UFS
        help
	  This selects the platform driver for the Cadence UFS host
	  controller present on present TI's J721e devices.

config UFS_PCI
	bool "PCI bus based UFS Controller support"
	depends on PCI && UFS
	help
	  This selects the PCI UFS Host Controller Interface. Select this if
	  you have UFS Host Controller with PCI Interface.

	  If you have a controller with this interface, say Y here.

	  If unsure, say N.

config QCOM_UFS
	bool "Qualcomm Host Controller driver for UFS"
	depends on UFS && ARCH_SNAPDRAGON
        help
	  This selects the platform driver for the UFS host
	  controller present on Qualcomm Snapdragon SoCs.

config TI_J721E_UFS
	bool "Glue Layer driver for UFS on TI J721E devices"
	help
	  This selects the glue layer driver for Cadence controller
	  present on TI's J721E devices.

config UFS_RENESAS
	bool "Renesas specific hooks to UFS controller platform driver"
	depends on UFS
	select BOUNCE_BUFFER
	help
	  This selects the Renesas specific additions to UFSHCD platform driver.
	  UFS host on Renesas needs some vendor specific configuration before
	  accessing the hardware.

config UFS_AMD_VERSAL2
	bool "AMD Versal Gen 2 UFS controller platform driver"
	depends on UFS && ZYNQMP_FIRMWARE
	help
	  This selects the AMD specific additions to UFSHCD platform driver.
	  UFS host on AMD needs some vendor specific configuration before accessing
	  the hardware.

config ROCKCHIP_UFS
	bool "Rockchip specific hooks to UFS controller platform driver"
	depends on UFS
	help
	  This selects the Rockchip specific additions to UFSHCD platform driver.
	  UFS host on Rockchip needs some vendor specific configuration before
	  accessing the hardware which includes PHY configuration and vendor
	  specific registers.

	  Select this if you have UFS controller on Rockchip chipset.
	  If unsure, say N.

config ROCKCHIP_UFS_RPMB
	bool "Support UFS replay protected memory block (RPMB)"
	depends on UFS && ROCKCHIP_UFS
	default y
	help
	  Enable support for reading, writing and programming the
	  key for the Replay Protection Memory Block partition in UFS.

config ROCKCHIP_UFS_DISABLED_LINKUP_TEST
	bool "Rockchip ufs disabled linkup test"
	depends on ROCKCHIP_UFS
	default N
	help
	  This selects to disabled linkup test for mphy power supply.

endmenu
```

## lib/dice/Kconfig
```kconfig
menuconfig DICE
	bool "DICE Support"
	depends on ANDROID_BOOT_IMAGE
	help
	  This option provides DICE support.

if DICE

config SPL_DICE
        bool "Enable dice for SPL"
	help
	  This option provides DICE support in SPL.

config DICE_WIDEVINE
	bool "DICE support Widevine"
	depends on ANDROID_BOOT_IMAGE
	default y
	help
	  This option provides support for Widevine.

endif # DICE
```

## lib/efi_driver/Kconfig
```kconfig
menu "GBL support"

config GBL
	bool "GBL support"
	depends on EFI_LOADER
	help
	  Enable support for GBL-specific EFI protocols and configuration.

if GBL
config GBL_VERIFY_BY_VBMETA
	bool "Verify GBL ESP by vbmeta"
	depends on ANDROID_BOOT_IMAGE
	depends on AVB_VERIFY
	depends on LIBAVB_VBMETA_PUBLIC_KEY_VALIDATE
	default y
	help
	  Verify the android_esp partition through vbmeta before entering GBL.

config GBL_EFI_BOOT_CONTROL_PROTOCOL
	bool "Include GBL Boot Control protocol"
	select CRC32
	help
	  Include the driver for the custom GBL Boot Control protocol.
	  This protocol is used for determining the current boot slot,
	  marking boot attempts, changing the currently active slot,
	  and querying metadata about boot slots.

config GBL_EFI_BOOT_MEMORY_PROTOCOL
	bool "Include GBL Boot Memory protocol"
	help
	  Include the driver for the custom GBL Boot Memory protocol.

config GBL_EFI_AVB_PROTOCOL
	bool "Include GBL Android Verified Boot protocol"
	help
	  Include the driver for the custom GBL Android Verified Boot protocol.
	  This protocol is used for platform-specific AVB logic, including
	  lock state management, rollback protection, and public key validation.

config GBL_EFI_FASTBOOT_PROTOCOL
	bool "Include GBL Fastboot customization protocol"
	help
	  Include the driver for the custom GBL Fastboot customization protocol.
	  This protocol is used for defining custom fastboot variables,
	  custom oem commands, and driving a device-local bootloader session.

config GBL_EFI_FASTBOOT_TRANSPORT_PROTOCOL
	bool "Include GBL Fastboot Transport protocol implementation"
	default y if GBL_EFI_FASTBOOT_TRANSPORT_PROTOCOL_SERIAL || GBL_EFI_FASTBOOT_TRANSPORT_PROTOCOL_DUMMY || GBL_EFI_FASTBOOT_TRANSPORT_PROTOCOL_USB
	help
	  Include the driver for the GBL Fastboot Transport protocol.
          This protocol is used for defining fastboot transport.

config GBL_EFI_FASTBOOT_TRANSPORT_PROTOCOL_USB
	bool "Include GBL Fastboot Transport protocol USB implementation"
	depends on USB_GADGET_DOWNLOAD && USB_FUNCTION_FASTBOOT
	help
	  Include the USB gadget driver for the GBL Fastboot Transport protocol.

config GBL_EFI_FASTBOOT_TRANSPORT_PROTOCOL_SERIAL
	bool "Include GBL Fastboot Transport protocol serial implementation"
	depends on CYCLIC
	help
	  Include the serial interactive driver for the GBL Fastboot Transport
          protocol. This protocol is used for defining fastboot transport.

config GBL_EFI_FASTBOOT_TRANSPORT_PROTOCOL_DUMMY
	bool "Include GBL Fastboot Transport protocol dummy implementation"
	depends on CYCLIC
	help
	  Include the dummy driver for the GBL Fastboot Transport protocol.
	  This protocol is used to verify multiple transport protocol
          registration and usage.

config GBL_EFI_OS_CONFIGURATION_PROTOCOL
	bool "Include GBL Os Configuration protocol"
	help
	  Include the driver for the custom GBL os configuration protocol.
	  This protocol is used to select base device trees and overlays
	  and apply runtime fix-ups to kernel commandline and bootconfig.

config GBL_EFI_FW_API_LEVEL
	bool "Enable GBL Firmware API Level"
	help
	  The API level of the platform firmware, in YYYYMM format.
	  This will be reported in the gbl_fw_api_level UEFI variable.
endif

endmenu
```

## lib/optee/Kconfig
```kconfig
config OPTEE_LIB
	bool "Support OPTEE library"
	default y if OPTEE || OPTEE_IMAGE
	help
	  Selecting this option will enable the shared OPTEE library code.

config OPTEE_IMAGE
	bool "Support OPTEE images"
	help
	  Selecting this option to boot OPTEE images.
	  This option enable the OPTEE specific checks done before booting
	  an OPTEE image created with mkimage

config OPTEE_TZDRAM_SIZE
	hex "Amount of Trust-Zone RAM for the OPTEE image"
	default 0x0000000
	depends on OPTEE_LIB
	help
	  The size of pre-allocated Trust Zone DRAM to allocate for the OPTEE
	  runtime.

config BOOTM_OPTEE
	bool "Support OPTEE bootm command"
	select BOOTM_LINUX
	select OPTEE_IMAGE
	help
	  Select this command to enable chain-loading of a Linux kernel
	  via an OPTEE firmware.
	  The bootflow is BootROM -> u-boot -> OPTEE -> Linux in this case.

config OPTEE_ALWAYS_USE_SECURITY_PARTITION
	bool "Support use security partition for OPTEE"
	depends on OPTEE
	help
	  U-Boot can secure store data to security partition
	  for nand or emmc, do not to store data to rpmb.
```
