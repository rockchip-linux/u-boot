## arch/arm/mach-rockchip/Kconfig.common
```kconfig
# SPDX-License-Identifier: GPL-2.0+

config ROCKCHIP_BOOT_MODE_REG
	hex "Rockchip boot mode flag register address"
	help
	  The SoC enters different boot modes (defined in
	  asm/arch-rockchip/boot_mode.h) according to the value read from this
	  register.

config ROCKCHIP_BOOTDEV
	string "Set the boot device for multiple storage board"
	default ""

config ROCKCHIP_FIT_IMAGE
	bool "Rockchip FIT image boot support"
	depends on FIT
	select CMD_BOOT_FIT
	default n

config ROCKCHIP_FIT_IMAGE_PACK
	bool "Rockchip fit image"
	default y

config ROCKCHIP_NEW_IDB
	bool "Rockchip new IDB header"
	default n
	help
	  The new IDB header was introduced from RK356X.

config ROCKCHIP_PRELOADER_ATAGS
	bool "Rockchip pre-loader atags support"
	default y if ARM

config ROCKCHIP_PRELOADER_SERIAL
	bool "Rockchip pre-loader serial"
	default y if ROCKCHIP_PRELOADER_ATAGS

config ROCKCHIP_RESOURCE_IMAGE
	bool "Rockchip resource image support"
	default y if ARM

config ROCKCHIP_HWID_DTB
	bool "Rockchip get dtb from resource image according to hw-id"
	depends on ROCKCHIP_RESOURCE_IMAGE
	default n

config ROCKCHIP_USB_BOOT
	bool "Rockchip USB(disk) boot support"
	depends on USB
	default n

config ROCKCHIP_UIMAGE
	bool "Rockchip UImage boot support"
	depends on !FIT_SIGNATURE
	select CMD_BOOT_UIMAGE
	default n

config ROCKCHIP_META
	bool "Rockchip Meta"
	depends on SPL_KERNEL_BOOT && SPL_LIBDISK_SUPPORT
	default n

config ROCKCHIP_VENDOR_PARTITION
	bool "Rockchip vendor partition support"
	default y if ARM

config ROCKCHIP_CMD
	string "Rockchip specific command"
	default ""
	help
	  It defines a command to be run when the key is pressed if assigned.
	  String format: "cmd key".
	  @cmd: any U-Boot cmd.
	  @key: any key map id, '-' standard for ignore.
	  e.g. "sd_update 115", 115 is KEY_VOLUMEUP.

config ROCKCHIP_SET_SN
	bool "Rockchip set serial number"
	default y if ARM

config ROCKCHIP_SET_ETHADDR
	bool "Rockchip set eth address"
	default y if ARM

config ROCKCHIP_SANITY_CPU_SWAP
	bool "Sanity cpu swap"
	help
	  This enale checking current cpu mpidr and kernel
	  dts cpu0 mpidr.

config PSTORE
	bool "Print log to linux pstore buffer"
	default n

if PSTORE
config PERSISTENT_RAM_ADDR
	hex "Linux pstore buffer address"
	depends on PSTORE
	default 0x0

config PERSISTENT_RAM_SIZE
	hex "Linux pstore buffer size"
	depends on (PERSISTENT_RAM_ADDR != 0)
	default 0x0
endif

config ROCKCHIP_MINIDUMP
	bool "Minidump Save Linux Debug Data To Ram Elf"
	default n
	help
	  This enable saving linux debug data to a reserved memory as a elf file.

if ROCKCHIP_MINIDUMP
config ROCKCHIP_MINIDUMP_SMEM_BASE
	hex "The base of share memory between Uboot and Linux"
	default 0x1f0000
	depends on ROCKCHIP_MINIDUMP
	help
	  This select the base address of share memory, which is behind PSTORE.

config ROCKCHIP_MINIDUMP_MAX_ELF_SIZE
	hex "The max size of minidump elf"
	default 0x2000000
	depends on ROCKCHIP_MINIDUMP
	help
	  This is used to judge the elf program size and section size.

config ROCKCHIP_MINIDUMP_MAX_ENTRIES
	hex "The max entries of minidump region"
	default 0x200
	depends on ROCKCHIP_MINIDUMP
	help
	  This sets the max entries of minidump region.
endif

config ROCKCHIP_UART_MUX_SEL_M
	int "UART mux select"
	depends on TPL
	default 0

config ROCKCHIP_EMMC_IOMUX
	bool "ROCKCHIP EMMC IOMUX"
	default n
	help
	  This enable U-Boot to config EMMC iomux.

config ROCKCHIP_NAND_IOMUX
	bool "ROCKCHIP NAND IOMUX"
	default n
	help
	  This enable U-Boot to config NAND iomux.

config ROCKCHIP_SFC_IOMUX
	bool "ROCKCHIP SFC QUAD SPI IOMUX"
	default n
	help
	  This enable U-Boot to config SFC Quad SPI iomux.

config ROCKCHIP_SDMMC_IOMUX
	bool "ROCKCHIP SDMMC IOMUX"
	default n
	help
	  This enable U-Boot to config SDMMC iomux.

config BASE_DEFCONFIG
	string "Base defconfig of config fragment"
	default ""
	help
	  Indicate the base defconfig of config fragment.

config CHIP_NAME
	string "Chip label name"
	default ""

config LOADER_INI
	string "Name of Loader ini file in rkbin repository"
	default ""
	help
	  The ini file is used to pack loader image.

config TRUST_INI
	string "Name of Trust ini file in rkbin repository"
	default ""
	help
	  The ini file is used to pack trust image.
```

## arch/arm/mach-rockchip/rk3538/Kconfig
```kconfig
if ROCKCHIP_RK3538

config TARGET_EVB_RK3538
	bool "EVB_RK3538"
	select BOARD_LATE_INIT
	help
	  RK3538 EVB is a evaluation board for Rockchp RK3538.

config ROCKCHIP_BOOT_MODE_REG
	default 0xfd181000

config ROCKCHIP_STIMER_BASE
	default 0xfd9b0000

config SYS_SOC
	default "rk3538"

source board/rockchip/evb_rk3538/Kconfig

config SYS_CONFIG_NAME
	default "rk3538_common"

endif
```

## arch/arm/mach-rockchip/rk3572/Kconfig
```kconfig
if ROCKCHIP_RK3572

config TARGET_EVB_RK3572
	bool "EVB_RK3572"
	select BOARD_LATE_INIT
	help
	  RK3572 EVB is a evaluation board for Rockchp RK3572.

config ROCKCHIP_BOOT_MODE_REG
	default 0x26043000

config ROCKCHIP_STIMER_BASE
	default 0x26740000

config SYS_SOC
	default "rk3572"

source board/rockchip/evb_rk3572/Kconfig

config SYS_CONFIG_NAME
	default "rk3572_common"

endif
```

## arch/arm/mach-rockchip/rk3576/Kconfig
```kconfig
if ROCKCHIP_RK3576

config TARGET_EVB_RK3576
	bool "EVB_RK3576"
	select BOARD_LATE_INIT
	help
	  RK3576 EVB is a evaluation board for Rockchp RK3576.

config TARGET_ROC_PC_RK3576
	bool "Firefly ROC-RK3576-PC"
	help
	  ROC-RK3576-PC is a single board computer from Firefly
	  using the Rockchip RK3576.

config ROCKCHIP_BOOT_MODE_REG
	default 0x26024040

config ROCKCHIP_STIMER_BASE
	default 0x27400000

config SYS_SOC
	default "rk3576"

source board/firefly/roc-pc-rk3576/Kconfig
source board/rockchip/evb_rk3576/Kconfig

config SYS_CONFIG_NAME
	default "rk3576_common"

endif
```

## arch/riscv/mach-rockchip/Kconfig
```kconfig
# SPDX-License-Identifier: GPL-2.0+
#
# Copyright (c) 2026 Rockchip Electronics Co., Ltd

if ARCH_ROCKCHIP

source "arch/arm/mach-rockchip/Kconfig.common"

config ROCKCHIP_RK182X
	bool "Support Rockchip RK182X"
	select THEAD_CACHE
	select SYS_CACHE_THEAD_CMO
	help
	  The Rockchip RK182X is a RISC-V (XuanTie C9xx) based SoC.
	  This option enables the RK182X SoC code and allows the Rockchip
	  build script (make.sh) to identify the chip for loader/trust
	  image packing.

source "arch/riscv/mach-rockchip/rk182x/Kconfig"
endif
```

## arch/riscv/mach-rockchip/rk182x/Kconfig
```kconfig
if ROCKCHIP_RK182X

config SYS_BOARD
	default "evb_rk182x"

config SYS_VENDOR
	default "rockchip"

config SYS_CPU
	default "generic"

config SYS_CONFIG_NAME
	default "rk182x_common"

config TEXT_BASE
	default 0x81000000 if SPL
	default 0x540400000 if RISCV_SMODE

config SPL_TEXT_BASE
	default 0x82000000

config SPL_OPENSBI_LOAD_ADDR
	default 0x540200000

config ROCKCHIP_BOOT_MODE_REG
	default 0x1030010200

config BOARD_SPECIFIC_OPTIONS # dummy
	def_bool y
	select ARCH_EARLY_INIT_R
	select SUPPORT_SPL
	imply CPU_RISCV
	imply RISCV_TIMER
	imply SPL_REGMAP
	imply SPL_SYSCON
	imply CMD_CPU
	imply SPL_CPU_SUPPORT
	imply SPL_MMC
endif
```

## board/rockchip/evb_rk3538/Kconfig
```kconfig
if TARGET_EVB_RK3538

config SYS_BOARD
	default "evb_rk3538"

config SYS_VENDOR
	default "rockchip"

config SYS_CONFIG_NAME
	default "evb_rk3538"

config BOARD_SPECIFIC_OPTIONS # dummy
	def_bool y

endif
```

## cmd/ddr_tool/Kconfig
```kconfig
menu "DDR Tool"

config CMD_DDR_TOOL
	bool "Enable DDR Tool"
	help
	  This enable ddr tool such as ddr dq eye, ddr test tool, memtester and stressapptest.

config CMD_MEMTESTER
	bool "Enable memtester for ddr"
	depends on CMD_DDR_TOOL
	help
	  This enables memtester for ddr.

config CMD_STRESSAPPTEST
	bool "Enable stressapptest for ddr"
	depends on CMD_DDR_TOOL
	help
	  This enables stressapptest for ddr.

endmenu
```

## configs/rk182x_defconfig
```kconfig
CONFIG_RISCV=y
CONFIG_ARCH_ROCKCHIP=y
CONFIG_TEXT_BASE=0x540400000
CONFIG_SYS_MALLOC_LEN=0xa00000
CONFIG_SYS_MALLOC_F_LEN=0x100000
CONFIG_NR_DRAM_BANKS=1
CONFIG_HAS_CUSTOM_SYS_INIT_SP_ADDR=y
CONFIG_CUSTOM_SYS_INIT_SP_ADDR=0x540600000
CONFIG_DEFAULT_DEVICE_TREE="rk182x-evb"
CONFIG_OF_LIBFDT_OVERLAY=y
CONFIG_DM_RESET=y
CONFIG_ROCKCHIP_FIT_IMAGE=y
CONFIG_ROCKCHIP_NEW_IDB=y
CONFIG_ROCKCHIP_PRELOADER_ATAGS=y
CONFIG_SPL_STACK=0x540600000
CONFIG_SPL_TEXT_BASE=0x540000000
CONFIG_SPL_BSS_START_ADDR=0x540100000
CONFIG_SYS_BOOTM_LEN=0x04000000
CONFIG_SYS_LOAD_ADDR=0x543000000
CONFIG_SPL=y
CONFIG_DEBUG_UART_BASE=0x1031880000
CONFIG_DEBUG_UART_CLOCK=24000000
CONFIG_SPL_LIBDISK_SUPPORT=y
CONFIG_SPL_PAYLOAD=""
CONFIG_BUILD_TARGET=""
CONFIG_SYS_CACHES_KEEP_ENABLED=y
CONFIG_SPL_SYS_CACHES_KEEP_ENABLED=y
CONFIG_ROCKCHIP_RK182X=y
CONFIG_ARCH_RV64I=y
CONFIG_CMODEL_MEDANY=y
CONFIG_RISCV_SMODE=y
# CONFIG_SPL_SMP is not set
# CONFIG_EXPERT is not set
# CONFIG_EFI_LOADER is not set
CONFIG_FIT=y
CONFIG_FIT_VERBOSE=y
CONFIG_SPL_FIT_PRINT=y
CONFIG_SPL_FIT_FULL_CHECK=y
CONFIG_SPL_LOAD_FIT=y
CONFIG_SPL_LOAD_FIT_ADDRESS=0x540f00000
CONFIG_SPL_FIT_IMAGE_POST_PROCESS=y
CONFIG_SPL_FIT_IMAGE_KB=2048
# CONFIG_LEGACY_IMAGE_FORMAT is not set
CONFIG_BOOTDELAY=0
CONFIG_BOOTCOMMAND="boot_fit"
CONFIG_SYS_CBSIZE=256
CONFIG_SYS_PBSIZE=284
CONFIG_DISPLAY_BOARDINFO=y
CONFIG_DISPLAY_BOARDINFO_LATE=y
# CONFIG_SKIP_RELOCATE_UBOOT is not set
CONFIG_BOARD_LATE_INIT=y
# CONFIG_ANDROID_AB is not set
CONFIG_SPL_MAX_SIZE=0x100000
# CONFIG_SPL_SHARES_INIT_SP_ADDR is not set
CONFIG_SPL_SYS_MALLOC=y
CONFIG_SYS_MMCSD_RAW_MODE_U_BOOT_USE_PARTITION=y
CONFIG_SYS_MMCSD_RAW_MODE_U_BOOT_PARTITION=0x9
CONFIG_SPL_CPU=y
CONFIG_SPL_CRYPTO=y
CONFIG_SPL_OPENSBI=y
CONFIG_SPL_OPENSBI_SCRATCH_OPTIONS=0x0
# CONFIG_CMD_CPU is not set
# CONFIG_BOOTM_NETBSD is not set
# CONFIG_BOOTM_PLAN9 is not set
# CONFIG_BOOTM_RTEMS is not set
# CONFIG_BOOTM_VXWORKS is not set
# CONFIG_CMD_RUN is not set
# CONFIG_CMD_IMI is not set
# CONFIG_CMD_XIMG is not set
# CONFIG_CMD_EXPORTENV is not set
# CONFIG_CMD_IMPORTENV is not set
# CONFIG_CMD_EDITENV is not set
# CONFIG_CMD_CRC32 is not set
CONFIG_CMD_MEMINFO=y
# CONFIG_CMD_LZMADEC is not set
# CONFIG_CMD_UNLZ4 is not set
# CONFIG_CMD_UNZIP is not set
CONFIG_CMD_GPT=y
# CONFIG_CMD_LOADB is not set
# CONFIG_CMD_LOADS is not set
CONFIG_CMD_LSBLK=y
CONFIG_CMD_MMC=y
CONFIG_CMD_READ=y
# CONFIG_CMD_ECHO is not set
# CONFIG_CMD_ITEST is not set
# CONFIG_CMD_SOURCE is not set
# CONFIG_CMD_SETEXPR is not set
# CONFIG_CMD_BLOCK_CACHE is not set
# CONFIG_CMD_DATE is not set
# CONFIG_CMD_SLEEP is not set
CONFIG_CMD_SYSBOOT=y
# CONFIG_DOS_PARTITION is not set
# CONFIG_SPL_PARTITION_UUIDS is not set
CONFIG_OF_LIVE=y
CONFIG_OF_SPL_REMOVE_PROPS="pinctrl-0 pinctrl-names interrupt-parent interrupts"
CONFIG_NO_NET=y
CONFIG_REGMAP=y
CONFIG_SYSCON=y
CONFIG_SPL_CLK=y
CONFIG_CPU=y
CONFIG_DM_HASH=y
CONFIG_HASH_SOFTWARE=y
# CONFIG_USB_FUNCTION_FASTBOOT is not set
# CONFIG_MMC_WRITE is not set
# CONFIG_MMC_HW_PARTITIONING is not set
# CONFIG_MMC_VERBOSE is not set
CONFIG_MMC_DW=y
CONFIG_MMC_DW_ROCKCHIP=y
CONFIG_PINCTRL=y
CONFIG_SPL_PINCTRL=y
CONFIG_DM_REGULATOR_FIXED=y
CONFIG_DM_REGULATOR_GPIO=y
CONFIG_RAM=y
# CONFIG_RAM_SIFIVE is not set
# CONFIG_RESET_ROCKCHIP is not set
CONFIG_DM_RTC=y
CONFIG_BAUDRATE=1500000
CONFIG_DEBUG_UART_NS16550=y
CONFIG_DEBUG_UART_SHIFT=2
CONFIG_SYS_NS16550_MEM32=y
CONFIG_TIMER_EARLY=y
CONFIG_USB=y
CONFIG_DM_USB_GADGET=y
CONFIG_USB_GADGET=y
CONFIG_FS_SQUASHFS=y
# CONFIG_RANDOM_UUID is not set
CONFIG_SPL_TINY_MEMSET=y
CONFIG_RSA=y
CONFIG_SPL_RSA=y
CONFIG_RSA_N_SIZE=0x200
CONFIG_RSA_E_SIZE=0x10
CONFIG_RSA_C_SIZE=0x20
CONFIG_GETOPT=y
```

## configs/rk3538-usbplug_defconfig
```kconfig
CONFIG_ARM=y
CONFIG_SKIP_LOWLEVEL_INIT=y
CONFIG_COUNTER_FREQUENCY=24000000
CONFIG_POSITION_INDEPENDENT=y
CONFIG_ARCH_ROCKCHIP=y
CONFIG_TEXT_BASE=0x00000000
CONFIG_SYS_MALLOC_F_LEN=0x10000
CONFIG_DEFAULT_DEVICE_TREE="rockchip/rk3538-evb"
CONFIG_ROCKCHIP_RK3538=y
CONFIG_ROCKCHIP_NEW_IDB=y
CONFIG_ROCKCHIP_LOWLEVEL_INIT=y
# CONFIG_ROCKCHIP_FIT_IMAGE_PACK is not set
CONFIG_ROCKCHIP_EMMC_IOMUX=y
CONFIG_TARGET_EVB_RK3538=y
CONFIG_SYS_LOAD_ADDR=0x00c00800
CONFIG_DEBUG_UART_BASE=0xfdc50000
CONFIG_DEBUG_UART_CLOCK=24000000
# CONFIG_ARMV8_SET_SMPEN is not set
CONFIG_DEBUG_UART=y
# CONFIG_EFI_LOADER is not set
# CONFIG_BOOTSTD is not set
CONFIG_BOOTDELAY=0
CONFIG_DEFAULT_FDT_FILE="rockchip/rk3538-evb.dtb"
# CONFIG_DISPLAY_CPUINFO is not set
CONFIG_SUPPORT_USBPLUG=y
# CONFIG_CMD_BDI is not set
# CONFIG_CMD_BOOTD is not set
# CONFIG_CMD_BOOTM is not set
# CONFIG_CMD_BOOTI is not set
# CONFIG_CMD_ELF is not set
# CONFIG_CMD_XIMG is not set
# CONFIG_CMD_LOADS is not set
CONFIG_CMD_USB_MASS_STORAGE=y
# CONFIG_CMD_ITEST is not set
# CONFIG_CMD_SOURCE is not set
# CONFIG_CMD_SETEXPR is not set
# CONFIG_CMD_NET is not set
CONFIG_OF_DTB_PROPS_REMOVE=y
CONFIG_OF_REMOVE_PROPS="clock-names interrupt-parent assigned-clocks assigned-clock-rates assigned-clock-parents pinctrl-0 pinctrl-names"
# CONFIG_USB_FUNCTION_FASTBOOT is not set
CONFIG_MMC_HS400_ES_SUPPORT=y
CONFIG_MMC_HS400_SUPPORT=y
CONFIG_MMC_SDHCI=y
CONFIG_MMC_SDHCI_SDMA=y
CONFIG_MMC_SDHCI_ROCKCHIP=y
CONFIG_PHY_ROCKCHIP_INNO_USB2=y
CONFIG_SCSI=y
CONFIG_BAUDRATE=1500000
CONFIG_DEBUG_UART_SHIFT=2
CONFIG_SYSRESET_PSCI=y
CONFIG_USB=y
CONFIG_USB_DWC3=y
CONFIG_USB_GADGET=y
CONFIG_USB_GADGET_PRODUCT_NUM=0x350a
CONFIG_USB_GADGET_DOWNLOAD=y
CONFIG_USB_FUNCTION_ROCKUSB=y
CONFIG_RSA=y
CONFIG_RSA_N_SIZE=0x100
CONFIG_RSA_E_SIZE=0x200
CONFIG_RSA_C_SIZE=0x80
CONFIG_ERRNO_STR=y
```
