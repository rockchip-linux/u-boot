## drivers/crypto/rockchip/Kconfig
```kconfig
config ROCKCHIP_RSA
	bool "Enable rockchip RSA support"
	depends on RSA
	depends on ROCKCHIP_CRYPTO_V1 || ROCKCHIP_CRYPTO_V2 || ROCKCHIP_CRYPTO_CE
	default y
	help
	  This enable RSA512/RSA1024/RSA2048 algorithm support for
	  rockchip crypto module.

config SPL_ROCKCHIP_RSA
	bool "Enable rockchip RSA support in spl"
	depends on SPL_RSA
	depends on SPL_ROCKCHIP_CRYPTO_V1 || SPL_ROCKCHIP_CRYPTO_V2 || SPL_ROCKCHIP_CRYPTO_CE
	default y
	help
	  This enable RSA512/RSA1024/RSA2048 algorithm support for
	  rockchip crypto module.

config ROCKCHIP_EC
	bool "Enable rockchip ECC/SM2 support"
	depends on ROCKCHIP_CRYPTO_V1 || ROCKCHIP_CRYPTO_V2 || ROCKCHIP_CRYPTO_CE
	default n
	help
	  This enable SM2/ECC192R1/ECC224R1/ECC256R1 algorithm support for
	  rockchip crypto module.

config SPL_ROCKCHIP_EC
	bool "Enable rockchip ECC/SM2 support in spl"
	depends on SPL_ROCKCHIP_CRYPTO_V1 || SPL_ROCKCHIP_CRYPTO_V2 || SPL_ROCKCHIP_CRYPTO_CE
	default n
	help
	  This enable SM2/ECC192R1/ECC224R1/ECC256R1 algorithm support for
	  rockchip crypto module.

config ROCKCHIP_CIPHER
	bool "Enable rockchip cipher support"
	depends on ROCKCHIP_CRYPTO_V1 || ROCKCHIP_CRYPTO_V2 || ROCKCHIP_CRYPTO_CE
	default n
	help
	  This enable DES/AES/SM4 algorithm support for
	  rockchip crypto module.

config SPL_ROCKCHIP_CIPHER
	bool "Enable rockchip cipher support in spl"
	depends on SPL_ROCKCHIP_CRYPTO_V1 || SPL_ROCKCHIP_CRYPTO_V2 || SPL_ROCKCHIP_CRYPTO_CE
	default n
	help
	  This enable DES/AES/SM4 algorithm support for
	  rockchip crypto module.

config ROCKCHIP_HMAC
	bool "Enable rockchip hmac support"
	depends on ROCKCHIP_CRYPTO_V1 || ROCKCHIP_CRYPTO_V2 || ROCKCHIP_CRYPTO_CE
	default n
	help
	  This enable HMAC algorithm support for
	  rockchip crypto module.

config SPL_ROCKCHIP_HMAC
	bool "Enable rockchip hmac support in spl"
	depends on SPL_ROCKCHIP_CRYPTO_V1 || SPL_ROCKCHIP_CRYPTO_V2 || SPL_ROCKCHIP_CRYPTO_CE
	default n
	help
	  This enable HMAC algorithm support for
	  rockchip crypto module.

config ROCKCHIP_CRYPTO_V1
	bool "Enable rockchip crypto v1 support"
	depends on CRYPTO_MANAGER
	help
	  This enable MD5/SHA1/SHA256/RSA512/RSA1024/RSA2048 algorithm support for
	  rockchip crypto v1 on platforms: rk3399/rk3368/rk3328/rk3229/rk3288/rk3128.

config SPL_ROCKCHIP_CRYPTO_V1
	bool "Enable rockchip crypto v1 support in spl"
	depends on SPL_CRYPTO_MANAGER
	help
	  This enable MD5/SHA1/SHA256/RSA512/RSA1024/RSA2048 algorithm support for
	  rockchip crypto v1 on platforms: rk3399/rk3368/rk3328/rk3229/rk3288/rk3128.

config ROCKCHIP_CRYPTO_V2
	bool "Enable rockchip crypto v2 support"
	depends on CRYPTO_MANAGER
	help
	  This enable MD5/SHA1/SHA256/RSA512/RSA1024/RSA2048 algorithm support for
	  rockchip crypto v2 on platforms: px30/rk3326/rk1808/rk3308.

config SPL_ROCKCHIP_CRYPTO_V2
	bool "Enable rockchip crypto v2 support in spl"
	depends on SPL_CRYPTO_MANAGER
	help
	  This enable MD5/SHA1/SHA256/RSA512/RSA1024/RSA2048 algorithm support for
	  rockchip crypto v2 on platforms: px30/rk3326/rk1808/rk3308.

config ROCKCHIP_CRYPTO_CE
	bool "Enable rockchip crypto ce support"
	depends on CRYPTO_MANAGER
	help
	  This enable MD5/SHA1/SHA256/RSA512/RSA1024/RSA2048/RSA3072/RSA4096 algorithm support for
	  rockchip crypto ce on platforms: rv1126b.

config SPL_ROCKCHIP_CRYPTO_CE
	bool "Enable rockchip crypto ce support in spl"
	depends on SPL_CRYPTO_MANAGER
	help
	  This enable MD5/SHA1/SHA256/RSA512/RSA1024/RSA2048/RSA3072/RSA4096 algorithm support for
	  rockchip crypto ce on platforms: rv1126b.
```

## drivers/hwspinlock/Kconfig
```kconfig
menu "Hardware Spinlock Support"

config DM_HWSPINLOCK
	bool "Enable Hardware Spinlock using Driver Model"
	depends on DM && OF_CONTROL
	help
	  Enable support for the Hardware Spinlock driver class.
	  The Hardware Spinlock module provides hardware assistance for
	  synchronizing the processes running on multiple processors in the device.

config SPL_DM_HWSPINLOCK
	bool "Enable Hardware Spinlock using Driver Model in SPL"
	depends on SPL_DM && SPL_OF_CONTROL
	help
	  Enable support for the Hardware Spinlock driver class in SPL.
	  The Hardware Spinlock module provides hardware assistance for
	  synchronizing the processes running on multiple processors in the device.

config HWSPINLOCK_ROCKCHIP
	bool "Rockchip Hardware Spinlock device"
	depends on DM_HWSPINLOCK && ARCH_ROCKCHIP
	help
	  Say y here to support the Rockchip Hardware Spinlock device, which
	  provides a synchronisation mechanism for the various processors
	  on the SoC.

config SPL_HWSPINLOCK_ROCKCHIP
	bool "Rockchip Hardware Spinlock device in SPL"
	depends on SPL_DM_HWSPINLOCK && ARCH_ROCKCHIP
	help
	  Say y here to support the Rockchip Hardware Spinlock device in SPL,
	  which provides a synchronisation mechanism for the various processors
	  on the SoC.
endmenu
```

## drivers/mtd/nand/spi/Kconfig
```kconfig
menuconfig MTD_SPI_NAND
	bool "SPI NAND device Support"
	depends on DM_MTD && DM_SPI
	select MTD_NAND_CORE
	select SPI_MEM
	help
	  This is the framework for the SPI NAND device drivers.

if MTD_SPI_NAND

config SPI_NAND_GIGADEVICE
	bool "GIGADEVICE SPI flash support"
	default y
	help
	  Add support for various GIGADEVICE SPI Nand flash chips

config SPI_NAND_MACRONIX
	bool "MACRONIX SPI flash support"
	default y
	help
	  Add support for various MACRONIX SPI Nand flash chips

config SPI_NAND_MICRON
	bool "MICRON SPI flash support"
	default y
	help
	  Add support for various MICRON SPI Nand flash chips

config SPI_NAND_TOSHIBA
	bool "TOSHIBA SPI flash support"
	default y
	help
	  Add support for various TOSHIBA SPI Nand flash chips

config SPI_NAND_WINBOND
	bool "WINBOND SPI flash support"
	default y
	help
	  Add support for various WINBOND SPI Nand flash chips

if SPI_NAND_WINBOND

config SPI_NAND_WINBOND_CONT_READ
	bool "WINBOND SPI flash continuous read support"
	default n
	help
	 Add support for WINBOND SPI Nand flash chips cont read.

endif

config SPI_NAND_DOSILICON
	bool "DOSILICON SPI flash support"
	default y
	help
	  Add support for various DOSILICON SPI Nand flash chips

config SPI_NAND_ESMT
	bool "ESMT SPI flash support"
	default y
	select SPI_NAND_MICRON
	help
	  Add support for various ESMT SPI Nand flash chips

config SPI_NAND_XINCUN
	bool "XINCUN SPI flash support"
	default y
	help
	  Add support for various XINCUN SPI Nand flash chips

config SPI_NAND_XTX
	bool "XTX SPI flash support"
	default y
	select SPI_NAND_MICRON
	help
	  Add support for various XTX SPI Nand flash chips

config SPI_NAND_HYF
	bool "HYF SPI flash support"
	default y
	help
	  Add support for various HYF SPI Nand flash chips

config SPI_NAND_FMSH
	bool "FMSH SPI flash support"
	default y
	help
	  Add support for various FMSH SPI Nand flash chips

config SPI_NAND_FORESEE
	bool "FORESEE SPI flash support"
	default y
	help
	  Add support for various FORESEE SPI Nand flash chips

config SPI_NAND_BIWIN
	bool "BIWIN SPI flash support"
	default y
	help
	  Add support for various BIWIN SPI Nand flash chips

config SPI_NAND_ETRON
	bool "ETRON SPI flash support"
	default y
	help
	  Add support for various ETRON SPI Nand flash chips

config SPI_NAND_JSC
	bool "JSC SPI flash support"
	default y
	help
	  Add support for various JSC SPI Nand flash chips

config SPI_NAND_SILICONGO
	bool "SILICONGO SPI flash support"
	default y
	help
	  Add support for various SILICONGO SPI Nand flash chips

config SPI_NAND_UNIM
	bool "UNIM SPI flash support"
	default y
	help
	  Add support for various UNIM SPI Nand flash chips

config SPI_NAND_SKYHIGH
	bool "SKYHIGH SPI flash support"
	default y
	help
	  Add support for various SKYHIGH SPI Nand flash chips

config SPI_NAND_GSTO
	bool "GSTO SPI flash support"
	default y
	help
	  Add support for various GSTO SPI Nand flash chips

config SPI_NAND_ZBIT
	bool "ZBIT SPI flash support"
	default y
	help
	  Add support for various ZBIT SPI Nand flash chips

config SPI_NAND_HIKSEMI
	bool "HIKSEMI SPI flash support"
	default y
	help
	  Add support for various HIKSEMI SPI Nand flash chips

config SPI_NAND_KINGSTON
	bool "KINGSTON SPI flash support"
	default y if !ROCKCHIP_RV1106
	help
	  Add support for various KINGSTON SPI Nand flash chips

config SPI_NAND_ISSI
	bool "ISSI SPI flash support"
	default y if !ROCKCHIP_RV1106
	help
	  Add support for various ISSI SPI Nand flash chips

config SPI_NAND_TITAN
	bool "TITAN SPI flash support"
	default y if !ROCKCHIP_RV1106
	help
	  Add support for various TITAN SPI Nand flash chips

config SPI_NAND_MK
	bool "MK SPI flash support"
	default y if !ROCKCHIP_RV1106
	help
	  Add support for various MK SPI Nand flash chips

config SPI_NAND_CHUCUN
	bool "CHUCUN SPI flash support"
	default y if !ROCKCHIP_RV1106
	help
	  Add support for various CHUCUN SPI Nand flash chips

config SPI_NAND_ICTHINK
	bool "IC-THINK SPI flash support"
	default y if !ROCKCHIP_RV1106
	help
	  Add support for various IC-THINK SPI Nand flash chips

config SPI_NAND_UNILC
	bool "UNILC SPI flash support"
	default y if !ROCKCHIP_RV1106
	help
	  Add support for various UNILC SPI Nand flash chips

config SPI_NAND_CONT_READ
	bool "Enable SPI flash continuous read support"
	default n
	help
	 Add support for SPI Nand flash chips cont read.
endif
```

## drivers/power/power_delivery/Kconfig
```kconfig
# SPDX-License-Identifier: GPL-2.0

config DM_POWER_DELIVERY
	bool "Enable Driver Model Power Delivery support"
	depends on DM
	help
	  This adds a simple uclass for power delivery.

if DM_POWER_DELIVERY

config TYPEC_PD_TCPM
	tristate "USB Type-C Port Controller Manager for USB and PD"
	help
	  The Type-C Port Controller Manager provides a USB PD and USB Type-C
	  state machine for use with Type-C Port Controllers.

config TYPEC_PD_TCPCI
	tristate "Type-C Port Controller Interface driver for USB and PD"
	depends on DM_I2C && TYPEC_PD_TCPM
	help
	  Type-C Port Controller driver for TCPCI-compliant controller.

if TYPEC_PD_TCPCI

config TYPEC_PD_HUSB311
	tristate "Hynetek HUSB311 Type-C chip driver for USB and PD"
	depends on DM_I2C
	help
	  Hynetek HUSB311 Type-C chip driver that works with
	  Type-C Port Controller Manager to provide USB PD and USB
	  Type-C functionalities.

endif # TYPEC_PD_TCPCI

config TYPEC_PD_FUSB302
	tristate "Fairchild FUSB302 Type-C chip driver for USB and PD"
	depends on DM_I2C && TYPEC_PD_TCPM
	help
	  The Fairchild FUSB302 Type-C chip driver that works with
	  Type-C Port Controller Manager to provide USB PD and USB
	  Type-C functionalities.

endif # DM_POWER_DELIVERY
```

## drivers/rng/Kconfig
```kconfig
config DM_RNG
	bool "Driver support for Random Number Generator devices"
	depends on DM
	help
	  Enable driver model for random number generator(rng) devices.
	  This interface is used to initialise the rng device and to
	  read the random seed from the device.

config SPL_DM_RNG
	bool "Driver support for Random Number Generator devices in spl"
	depends on SPL_DM
	---help---
	This config enables the dm crypto support.

if DM_RNG

config RNG_ROCKCHIP
	bool "Enable random number generator for rockchip crypto rng"
	depends on ARCH_ROCKCHIP && DM_RNG
	default n
	help
	  Enable random number generator for rockchip.This driver is
	  support rng module of crypto v1 and crypto v2.

config SPL_RNG_ROCKCHIP
	bool "Enable random number generator for rockchip crypto rng in spl"
	depends on ARCH_ROCKCHIP && DM_RNG
	default n
	help
	  Enable random number generator for rockchip.This driver is
	  support rng module of crypto v1 and crypto v2.

endif
```
