## configs/rk3538_defconfig
```kconfig
CONFIG_ARM=y
CONFIG_SKIP_LOWLEVEL_INIT=y
CONFIG_ARCH_ROCKCHIP=y
CONFIG_TEXT_BASE=0x00200000
CONFIG_SYS_MALLOC_F_LEN=0x10000
CONFIG_SPL_LIBCOMMON_SUPPORT=y
CONFIG_SPL_LIBGENERIC_SUPPORT=y
CONFIG_HAS_CUSTOM_SYS_INIT_SP_ADDR=y
CONFIG_CUSTOM_SYS_INIT_SP_ADDR=0x00600000
CONFIG_DEFAULT_DEVICE_TREE="rockchip/rk3538-evb"
CONFIG_ROCKCHIP_RK3538=y
CONFIG_SPL_ROCKCHIP_COMMON_BOARD=y
# CONFIG_ROCKCHIP_DISABLE_FORCE_JTAG is not set
CONFIG_ROCKCHIP_NEW_IDB=y
CONFIG_ROCKCHIP_FIT_IMAGE=y
CONFIG_ROCKCHIP_LOWLEVEL_INIT=y
CONFIG_SPL_DRIVERS_MISC=y
CONFIG_TARGET_EVB_RK3538=y
CONFIG_SPL_STACK=0x04000000
CONFIG_SPL_SYS_MALLOC_F_LEN=0x200000
CONFIG_SPL_TEXT_BASE=0x03d00000
CONFIG_SPL_HAS_BSS_LINKER_SECTION=y
CONFIG_SPL_BSS_START_ADDR=0x03d60000
CONFIG_SPL_BSS_MAX_SIZE=0x00020000
CONFIG_SYS_LOAD_ADDR=0x00c00800
CONFIG_DEBUG_UART_BASE=0xfdc50000
CONFIG_DEBUG_UART_CLOCK=24000000
CONFIG_SPL_LIBDISK_SUPPORT=y
CONFIG_SPL_SPI_FLASH_SUPPORT=y
CONFIG_SPL_SPI=y
# CONFIG_ARMV8_SET_SMPEN is not set
CONFIG_BUILD_TARGET=""
CONFIG_DEBUG_UART=y
# CONFIG_SPL_SYS_MALLOC_CLEAR_ON_INIT is not set
# CONFIG_EFI_LOADER is not set
CONFIG_BUTTON_CMD=y
CONFIG_ANDROID_BOOT_IMAGE_HASH=y
CONFIG_FIT_EXTERNAL_OFFSET=0x1000
CONFIG_FIT_CIPHER=y
CONFIG_FIT_VERBOSE=y
CONFIG_FIT_BEST_MATCH=y
CONFIG_FIT_HW_CRYPTO=y
CONFIG_SPL_FIT_PRINT=y
CONFIG_SPL_FIT_FULL_CHECK=y
CONFIG_SPL_FIT_IMAGE_POST_PROCESS=y
CONFIG_SPL_FIT_HW_CRYPTO=y
CONFIG_BOOTDELAY=0
CONFIG_USE_PREBOOT=y
CONFIG_DEFAULT_FDT_FILE="rockchip/rk3538-evb.dtb"
# CONFIG_CONSOLE_MUX is not set
# CONFIG_DISPLAY_CPUINFO is not set
CONFIG_DISPLAY_BOARDINFO_LATE=y
# CONFIG_CYCLIC is not set
CONFIG_LAST_STAGE_INIT=y
# CONFIG_MISC_INIT_R is not set
CONFIG_AVB_VERIFY=y
CONFIG_AVB_BUF_ADDR=0x02000000
CONFIG_AVB_BUF_SIZE=0x2000000
CONFIG_BOARD_RNG_SEED=y
CONFIG_SPL_MAX_SIZE=0x80000
CONFIG_SPL_PAD_TO=0x7f8000
# CONFIG_SPL_RAW_IMAGE_SUPPORT is not set
# CONFIG_SPL_SHARES_INIT_SP_ADDR is not set
CONFIG_SYS_MMCSD_RAW_MODE_U_BOOT_USE_PARTITION=y
CONFIG_SYS_MMCSD_RAW_MODE_U_BOOT_PARTITION=0x1
CONFIG_SPL_CRYPTO=y
CONFIG_SPL_MTD=y
CONFIG_SPL_DM_RESET=y
CONFIG_SPL_RESET_ROCKCHIP=y
# CONFIG_SPL_SPI_FLASH_TINY is not set
CONFIG_SPL_SPI_FLASH_SFDP_SUPPORT=y
CONFIG_SPL_SPI_FLASH_MTD=y
CONFIG_SPL_AB=y
CONFIG_CMD_BOOTZ=y
CONFIG_CMD_GPIO=y
CONFIG_CMD_GPT=y
CONFIG_CMD_MMC=y
CONFIG_CMD_NAND=y
CONFIG_CMD_USB=y
CONFIG_CMD_USB_MASS_STORAGE=y
# CONFIG_CMD_SETEXPR is not set
# CONFIG_CMD_CLS is not set
CONFIG_CMD_REGULATOR=y
CONFIG_CMD_HASH=y
# CONFIG_SPL_DOS_PARTITION is not set
CONFIG_OF_SPL_REMOVE_PROPS="clock-names interrupt-parent assigned-clocks assigned-clock-rates assigned-clock-parents"
CONFIG_OF_DTB_PROPS_REMOVE=y
CONFIG_OF_REMOVE_PROPS="interrupt-parent assigned-clocks assigned-clock-rates assigned-clock-parents"
CONFIG_SYS_REDUNDAND_ENVIRONMENT=y
# CONFIG_SYS_RELOC_GD_ENV_ADDR is not set
CONFIG_SARADC_ROCKCHIP_V2=y
CONFIG_BUTTON=y
CONFIG_BUTTON_ADC=y
CONFIG_BUTTON_GPIO=y
CONFIG_CLK_SCMI=y
CONFIG_CRYPTO_MANAGER=y
CONFIG_SPL_CRYPTO_MANAGER=y
CONFIG_DM_HASH=y
CONFIG_HASH_SOFTWARE=y
CONFIG_ROCKCHIP_CRYPTO_CE=y
CONFIG_SPL_ROCKCHIP_CRYPTO_CE=y
CONFIG_FASTBOOT_BUF_ADDR=0xc00800
CONFIG_FASTBOOT_BUF_SIZE=0x07000000
CONFIG_SCMI_FIRMWARE=y
CONFIG_ROCKCHIP_GPIO=y
CONFIG_SYS_I2C_ROCKCHIP=y
CONFIG_IRQ_GPIO_V2=y
CONFIG_SUPPORT_EMMC_RPMB=y
CONFIG_MMC_HS400_ES_SUPPORT=y
CONFIG_SPL_MMC_HS400_ES_SUPPORT=y
CONFIG_MMC_HS400_SUPPORT=y
CONFIG_SPL_MMC_HS400_SUPPORT=y
CONFIG_MMC_DW=y
CONFIG_MMC_DW_ROCKCHIP=y
CONFIG_MMC_SDHCI=y
CONFIG_MMC_SDHCI_SDMA=y
CONFIG_MMC_SDHCI_ROCKCHIP=y
CONFIG_DM_MTD=y
CONFIG_MTD_BLK=y
CONFIG_MTD_RAW_NAND=y
CONFIG_SYS_NAND_USE_FLASH_BBT=y
CONFIG_NAND_ROCKCHIP=y
CONFIG_SYS_NAND_ONFI_DETECTION=y
CONFIG_MTD_SPI_NAND=y
CONFIG_SPI_FLASH_SFDP_SUPPORT=y
CONFIG_SPI_FLASH_GIGADEVICE=y
CONFIG_SPI_FLASH_MACRONIX=y
CONFIG_SPI_FLASH_PUYA=y
CONFIG_SPI_FLASH_WINBOND=y
CONFIG_SPI_FLASH_XMC=y
CONFIG_SPI_FLASH_XTX=y
CONFIG_SPI_FLASH_ZBIT=y
# CONFIG_SPI_FLASH_USE_4K_SECTORS is not set
CONFIG_SPI_FLASH_MTD=y
CONFIG_PHY_REALTEK=y
CONFIG_PHY_ROCKCHIP=y
CONFIG_DWC_ETH_QOS=y
CONFIG_DWC_ETH_QOS_ROCKCHIP=y
CONFIG_PHY_ROCKCHIP_INNO_USB2=y
CONFIG_DM_PMIC=y
CONFIG_PMIC_RK8XX=y
CONFIG_REGULATOR_PWM=y
CONFIG_DM_REGULATOR_GPIO=y
CONFIG_REGULATOR_RK8XX=y
CONFIG_PWM_ROCKCHIP=y
CONFIG_SCSI=y
CONFIG_BAUDRATE=1500000
CONFIG_DEBUG_UART_SHIFT=2
CONFIG_SYS_NS16550_MEM32=y
CONFIG_ROCKCHIP_SFC=y
CONFIG_ROCKCHIP_SPI=y
CONFIG_SYSRESET_PSCI=y
CONFIG_TEE=y
CONFIG_OPTEE=y
CONFIG_ROCKCHIP_OPTEE_V3=y
CONFIG_USB=y
CONFIG_USB_XHCI_HCD=y
CONFIG_USB_XHCI_DWC3=y
CONFIG_USB_EHCI_HCD=y
CONFIG_USB_EHCI_GENERIC=y
CONFIG_USB_OHCI_HCD=y
CONFIG_USB_OHCI_GENERIC=y
CONFIG_USB_DWC3=y
CONFIG_USB_DWC3_GENERIC=y
CONFIG_USB_GADGET=y
CONFIG_USB_GADGET_PRODUCT_NUM=0x350a
CONFIG_USB_FUNCTION_ROCKUSB=y
CONFIG_VIDEO=y
CONFIG_DISPLAY=y
CONFIG_DRM_ROCKCHIP=y
CONFIG_DRM_ROCKCHIP_DW_HDMI_QP=y
CONFIG_ROCKCHIP_INNO_HDMI_PHY=y
CONFIG_DRM_ROCKCHIP_TVE=y
# CONFIG_RANDOM_UUID is not set
CONFIG_RSA=y
CONFIG_SPL_RSA=y
CONFIG_RSA_N_SIZE=0x200
CONFIG_RSA_E_SIZE=0x10
CONFIG_RSA_C_SIZE=0x20
CONFIG_XBC=y
CONFIG_LIBAVB=y
CONFIG_LIBAVB_AB=y
CONFIG_SPL_GZIP=y
CONFIG_ERRNO_STR=y
CONFIG_OPTEE_ALWAYS_USE_SECURITY_PARTITION=y
```

## configs/rk3572-usbplug_defconfig
```kconfig
CONFIG_ARM=y
CONFIG_SKIP_LOWLEVEL_INIT=y
CONFIG_POSITION_INDEPENDENT=y
CONFIG_ARCH_ROCKCHIP=y
CONFIG_TEXT_BASE=0x40000000
CONFIG_SYS_MALLOC_F_LEN=0x10000
CONFIG_DEFAULT_DEVICE_TREE="rockchip/rk3572-evb"
CONFIG_ROCKCHIP_RK3572=y
CONFIG_ROCKCHIP_NEW_IDB=y
# CONFIG_ROCKCHIP_VENDOR_PARTITION is not set
CONFIG_ROCKCHIP_LOWLEVEL_INIT=y
CONFIG_ROCKCHIP_EMMC_IOMUX=y
CONFIG_TARGET_EVB_RK3572=y
CONFIG_SYS_LOAD_ADDR=0x40c00800
CONFIG_DEBUG_UART_BASE=0x2c130000
CONFIG_DEBUG_UART_CLOCK=24000000
# CONFIG_ARMV8_SET_SMPEN is not set
CONFIG_DEBUG_UART=y
# CONFIG_EFI_LOADER is not set
# CONFIG_BOOTSTD is not set
CONFIG_BOOTDELAY=0
CONFIG_DEFAULT_FDT_FILE="rockchip/rk3572-evb.dtb"
# CONFIG_DISPLAY_CPUINFO is not set
CONFIG_SUPPORT_USBPLUG=y
# CONFIG_CMD_BDI is not set
# CONFIG_CMD_BOOTD is not set
# CONFIG_CMD_BOOTM is not set
# CONFIG_CMD_BOOTI is not set
# CONFIG_CMD_ELF is not set
# CONFIG_CMD_XIMG is not set
# CONFIG_CMD_LOADS is not set
CONFIG_CMD_USB_MASS_STORAGE=y
# CONFIG_CMD_ITEST is not set
# CONFIG_CMD_SOURCE is not set
# CONFIG_CMD_SETEXPR is not set
# CONFIG_CMD_NET is not set
CONFIG_OF_DTB_PROPS_REMOVE=y
CONFIG_OF_REMOVE_PROPS="clock-names interrupt-parent assigned-clocks assigned-clock-rates assigned-clock-parents pinctrl-0 pinctrl-names"
CONFIG_SYS_REDUNDAND_ENVIRONMENT=y
# CONFIG_USB_FUNCTION_FASTBOOT is not set
CONFIG_MMC_HS400_ES_SUPPORT=y
CONFIG_MMC_HS400_SUPPORT=y
CONFIG_MMC_SDHCI=y
CONFIG_MMC_SDHCI_SDMA=y
CONFIG_MMC_SDHCI_ROCKCHIP=y
CONFIG_DM_MTD=y
CONFIG_MTD_BLK=y
CONFIG_MTD_SPI_NAND=y
# CONFIG_SPI_NAND_MICRON is not set
# CONFIG_SPI_NAND_TOSHIBA is not set
# CONFIG_SPI_NAND_DOSILICON is not set
# CONFIG_SPI_NAND_ESMT is not set
# CONFIG_SPI_NAND_XINCUN is not set
# CONFIG_SPI_NAND_XTX is not set
# CONFIG_SPI_NAND_HYF is not set
# CONFIG_SPI_NAND_FMSH is not set
# CONFIG_SPI_NAND_FORESEE is not set
# CONFIG_SPI_NAND_BIWIN is not set
# CONFIG_SPI_NAND_ETRON is not set
# CONFIG_SPI_NAND_JSC is not set
# CONFIG_SPI_NAND_SILICONGO is not set
# CONFIG_SPI_NAND_UNIM is not set
# CONFIG_SPI_NAND_SKYHIGH is not set
# CONFIG_SPI_NAND_GSTO is not set
# CONFIG_SPI_NAND_ZBIT is not set
# CONFIG_SPI_NAND_HIKSEMI is not set
# CONFIG_SPI_NAND_KINGSTON is not set
# CONFIG_SPI_NAND_ISSI is not set
CONFIG_SPI_FLASH_SFDP_SUPPORT=y
CONFIG_SPI_FLASH_GIGADEVICE=y
CONFIG_SPI_FLASH_MACRONIX=y
CONFIG_SPI_FLASH_WINBOND=y
# CONFIG_SPI_FLASH_USE_4K_SECTORS is not set
CONFIG_PHY_ROCKCHIP_INNO_USB2=y
CONFIG_PHY_ROCKCHIP_NANENG_COMBOPHY=y
CONFIG_SCSI=y
CONFIG_BAUDRATE=1500000
CONFIG_DEBUG_UART_SHIFT=2
CONFIG_ROCKCHIP_SFC=y
CONFIG_SYSRESET_PSCI=y
CONFIG_USB=y
CONFIG_USB_DWC3=y
CONFIG_USB_GADGET=y
CONFIG_USB_GADGET_PRODUCT_NUM=0x351a
CONFIG_USB_GADGET_DOWNLOAD=y
CONFIG_USB_FUNCTION_ROCKUSB=y
CONFIG_UFS=y
CONFIG_ROCKCHIP_UFS=y
CONFIG_RSA=y
CONFIG_RSA_N_SIZE=0x100
CONFIG_RSA_E_SIZE=0x200
CONFIG_RSA_C_SIZE=0x80
CONFIG_ERRNO_STR=y
```

## configs/rk3572_defconfig
```kconfig
CONFIG_ARM=y
CONFIG_SKIP_LOWLEVEL_INIT=y
CONFIG_COUNTER_FREQUENCY=24000000
CONFIG_ARCH_ROCKCHIP=y
CONFIG_TEXT_BASE=0x40200000
CONFIG_SYS_MALLOC_F_LEN=0x100000
CONFIG_SPL_LIBCOMMON_SUPPORT=y
CONFIG_SPL_LIBGENERIC_SUPPORT=y
CONFIG_HAS_CUSTOM_SYS_INIT_SP_ADDR=y
CONFIG_CUSTOM_SYS_INIT_SP_ADDR=0x40600000
CONFIG_DEFAULT_DEVICE_TREE="rockchip/rk3572-evb"
CONFIG_ROCKCHIP_RK3572=y
CONFIG_SPL_ROCKCHIP_COMMON_BOARD=y
# CONFIG_ROCKCHIP_DISABLE_FORCE_JTAG is not set
CONFIG_ROCKCHIP_NEW_IDB=y
CONFIG_ROCKCHIP_FIT_IMAGE=y
CONFIG_ROCKCHIP_LOWLEVEL_INIT=y
CONFIG_ROCKCHIP_SDMMC_IOMUX=y
CONFIG_SPL_DRIVERS_MISC=y
CONFIG_TARGET_EVB_RK3572=y
CONFIG_SPL_STACK=0x44000000
CONFIG_SPL_SYS_MALLOC_F_LEN=0x200000
CONFIG_SPL_TEXT_BASE=0x43d00000
CONFIG_SPL_HAS_BSS_LINKER_SECTION=y
CONFIG_SPL_BSS_START_ADDR=0x43d60000
CONFIG_SPL_BSS_MAX_SIZE=0x00020000
CONFIG_SYS_LOAD_ADDR=0x40c00800
CONFIG_DEBUG_UART_BASE=0x2c130000
CONFIG_DEBUG_UART_CLOCK=24000000
CONFIG_SPL_LIBDISK_SUPPORT=y
CONFIG_SPL_SPI_FLASH_SUPPORT=y
CONFIG_SPL_SPI=y
# CONFIG_ARMV8_SET_SMPEN is not set
CONFIG_BUILD_TARGET=""
CONFIG_DEBUG_UART=y
# CONFIG_SPL_SYS_MALLOC_CLEAR_ON_INIT is not set
# CONFIG_EFI_LOADER is not set
CONFIG_BUTTON_CMD=y
CONFIG_ANDROID_BOOT_IMAGE_HASH=y
CONFIG_FIT_EXTERNAL_OFFSET=0x1000
CONFIG_FIT_CIPHER=y
CONFIG_FIT_VERBOSE=y
CONFIG_FIT_BEST_MATCH=y
CONFIG_SPL_FIT_PRINT=y
CONFIG_SPL_FIT_FULL_CHECK=y
CONFIG_SPL_FIT_IMAGE_POST_PROCESS=y
CONFIG_SPL_FIT_HW_CRYPTO=y
CONFIG_BOOTDELAY=0
CONFIG_USE_PREBOOT=y
CONFIG_DEFAULT_FDT_FILE="rockchip/rk3572-evb.dtb"
# CONFIG_CONSOLE_MUX is not set
# CONFIG_DISPLAY_CPUINFO is not set
CONFIG_DISPLAY_BOARDINFO_LATE=y
# CONFIG_CYCLIC is not set
CONFIG_LAST_STAGE_INIT=y
# CONFIG_MISC_INIT_R is not set
CONFIG_AVB_VERIFY=y
CONFIG_AVB_BUF_ADDR=0x42000000
CONFIG_AVB_BUF_SIZE=0x2000000
CONFIG_BOARD_RNG_SEED=y
CONFIG_SPL_MAX_SIZE=0x80000
CONFIG_SPL_PAD_TO=0x7f8000
# CONFIG_SPL_RAW_IMAGE_SUPPORT is not set
# CONFIG_SPL_SHARES_INIT_SP_ADDR is not set
CONFIG_SYS_MMCSD_RAW_MODE_U_BOOT_USE_PARTITION=y
CONFIG_SYS_MMCSD_RAW_MODE_U_BOOT_PARTITION=0x1
CONFIG_SPL_CRYPTO=y
CONFIG_SPL_MTD=y
CONFIG_SPL_UFS=y
CONFIG_SPL_DM_RESET=y
CONFIG_SPL_RESET_ROCKCHIP=y
# CONFIG_SPL_SPI_FLASH_TINY is not set
CONFIG_SPL_SPI_FLASH_SFDP_SUPPORT=y
CONFIG_SPL_AB=y
CONFIG_CMD_GPIO=y
CONFIG_CMD_GPT=y
CONFIG_CMD_MMC=y
CONFIG_CMD_MTD=y
CONFIG_CMD_USB=y
CONFIG_CMD_USB_MASS_STORAGE=y
# CONFIG_CMD_SETEXPR is not set
# CONFIG_CMD_CLS is not set
CONFIG_CMD_REGULATOR=y
CONFIG_CMD_HASH=y
# CONFIG_SPL_DOS_PARTITION is not set
CONFIG_OF_SPL_REMOVE_PROPS="clock-names interrupt-parent assigned-clocks assigned-clock-rates assigned-clock-parents"
CONFIG_OF_DTB_PROPS_REMOVE=y
CONFIG_OF_REMOVE_PROPS="clock-names interrupt-parent assigned-clocks assigned-clock-rates assigned-clock-parents"
# CONFIG_SYS_RELOC_GD_ENV_ADDR is not set
CONFIG_SARADC_ROCKCHIP_V2=y
CONFIG_BUTTON=y
CONFIG_BUTTON_ADC=y
CONFIG_BUTTON_GPIO=y
CONFIG_BUTTON_RK8XX=y
CONFIG_CLK_SCMI=y
CONFIG_CRYPTO_MANAGER=y
CONFIG_SPL_CRYPTO_MANAGER=y
CONFIG_DM_HASH=y
CONFIG_HASH_SOFTWARE=y
CONFIG_ROCKCHIP_CRYPTO_CE=y
CONFIG_SPL_ROCKCHIP_CRYPTO_CE=y
CONFIG_FASTBOOT_BUF_ADDR=0x40c00800
CONFIG_FASTBOOT_BUF_SIZE=0x07000000
CONFIG_SCMI_FIRMWARE=y
CONFIG_ROCKCHIP_GPIO=y
CONFIG_SYS_I2C_ROCKCHIP=y
CONFIG_SPL_ROCKCHIP_SECURE_OTP=y
CONFIG_IRQ_GPIO_V2=y
CONFIG_SUPPORT_EMMC_RPMB=y
CONFIG_MMC_HS400_ES_SUPPORT=y
CONFIG_SPL_MMC_HS400_ES_SUPPORT=y
CONFIG_MMC_HS400_SUPPORT=y
CONFIG_SPL_MMC_HS400_SUPPORT=y
CONFIG_MMC_DW=y
CONFIG_MMC_DW_ROCKCHIP=y
CONFIG_MMC_SDHCI=y
CONFIG_MMC_SDHCI_SDMA=y
CONFIG_MMC_SDHCI_ROCKCHIP=y
CONFIG_DM_MTD=y
CONFIG_MTD_BLK=y
CONFIG_MTD_SPI_NAND=y
CONFIG_SPI_FLASH_SFDP_SUPPORT=y
CONFIG_SPI_FLASH_MACRONIX=y
CONFIG_SPI_FLASH_XMC=y
CONFIG_SPI_FLASH_MTD=y
CONFIG_PHY_ROCKCHIP_INNO_USB2=y
CONFIG_PHY_ROCKCHIP_NANENG_COMBOPHY=y
CONFIG_PHY_ROCKCHIP_SAMSUNG_HDPTX=y
CONFIG_DM_PMIC=y
CONFIG_PMIC_RK8XX=y
CONFIG_DM_POWER_DELIVERY=y
CONFIG_TYPEC_PD_TCPM=y
CONFIG_TYPEC_PD_TCPCI=y
CONFIG_TYPEC_PD_HUSB311=y
CONFIG_TYPEC_PD_FUSB302=y
CONFIG_TYPEC_PD_ROCKCHIP_PMIC=y
CONFIG_REGULATOR_PWM=y
CONFIG_DM_REGULATOR_GPIO=y
CONFIG_REGULATOR_RK8XX=y
CONFIG_CHARGE_ANIMATION=y
CONFIG_CHARGER_SGM41542=y
CONFIG_CHARGER_SY6974B=y
CONFIG_DM_CHARGE_DISPLAY=y
CONFIG_DM_FUEL_GAUGE=y
CONFIG_POWER_FG_CW221X=y
CONFIG_POWER_FG_RK817=y
CONFIG_PWM_ROCKCHIP=y
CONFIG_SCSI=y
CONFIG_BAUDRATE=1500000
CONFIG_DEBUG_UART_SHIFT=2
CONFIG_SYS_NS16550_MEM32=y
CONFIG_ROCKCHIP_SFC=y
CONFIG_ROCKCHIP_SPI=y
CONFIG_SYSRESET_PSCI=y
CONFIG_SYSRESET_RK8XX=y
CONFIG_TEE=y
CONFIG_OPTEE=y
CONFIG_ROCKCHIP_OPTEE_V3=y
CONFIG_USB=y
CONFIG_USB_XHCI_HCD=y
CONFIG_USB_DWC3=y
CONFIG_USB_DWC3_GENERIC=y
CONFIG_USB_GADGET=y
CONFIG_USB_GADGET_PRODUCT_NUM=0x351a
CONFIG_USB_FUNCTION_ROCKUSB=y
CONFIG_UFS=y
CONFIG_ROCKCHIP_UFS=y
CONFIG_VIDEO=y
CONFIG_DISPLAY=y
CONFIG_DRM_ROCKCHIP=y
CONFIG_DRM_ROCKCHIP_DW_HDMI_QP=y
CONFIG_DRM_ROCKCHIP_INNO_VIDEO_COMBO_PHY=y
CONFIG_DRM_ROCKCHIP_DW_MIPI_DSI=y
CONFIG_DRM_ROCKCHIP_ANALOGIX_DP=y
CONFIG_DRM_ROCKCHIP_RGB=y
# CONFIG_RANDOM_UUID is not set
CONFIG_RSA=y
CONFIG_SPL_RSA=y
CONFIG_RSA_N_SIZE=0x200
CONFIG_RSA_E_SIZE=0x10
CONFIG_RSA_C_SIZE=0x20
CONFIG_XBC=y
CONFIG_LIBAVB=y
CONFIG_LIBAVB_AB=y
CONFIG_SPL_GZIP=y
CONFIG_ERRNO_STR=y
CONFIG_OPTEE_ALWAYS_USE_SECURITY_PARTITION=y
```
