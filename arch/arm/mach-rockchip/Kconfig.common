## configs/rk3576_defconfig
```kconfig
CONFIG_ARM=y
CONFIG_SKIP_LOWLEVEL_INIT=y
CONFIG_ARCH_ROCKCHIP=y
CONFIG_TEXT_BASE=0x40200000
CONFIG_SYS_MALLOC_F_LEN=0x80000
CONFIG_CUSTOM_SYS_INIT_SP_ADDR=0x40600000
CONFIG_DEFAULT_DEVICE_TREE="rockchip/rk3576-evb"
CONFIG_ROCKCHIP_RK3576=y
CONFIG_ROCKCHIP_NEW_IDB=y
CONFIG_ROCKCHIP_FIT_IMAGE=y
CONFIG_ROCKCHIP_LOWLEVEL_INIT=y
CONFIG_SPL_DRIVERS_MISC=y
CONFIG_SPL_STACK_R_ADDR=0x43e00000
CONFIG_TARGET_EVB_RK3576=y
CONFIG_SPL_TEXT_BASE=0x40000000
CONFIG_SPL_BSS_START_ADDR=0x43fe0000
CONFIG_SPL_BSS_MAX_SIZE=0x00010000
CONFIG_SPL_STACK_R=y
CONFIG_SYS_LOAD_ADDR=0x40c00800
CONFIG_DEBUG_UART_BASE=0x2AD40000
CONFIG_DEBUG_UART_CLOCK=24000000
CONFIG_SPL_LIBDISK_SUPPORT=y
CONFIG_SPL_SPI_FLASH_SUPPORT=y
CONFIG_SPL_SPI=y
# CONFIG_ARMV8_SET_SMPEN is not set
CONFIG_BUILD_TARGET=""
CONFIG_DEBUG_UART=y
# CONFIG_EFI_LOADER is not set
CONFIG_IMAGE_GZIP=y
CONFIG_ANDROID_BOOT_IMAGE=y
CONFIG_BUTTON_CMD=y
CONFIG_ANDROID_BOOT_IMAGE_HASH=y
CONFIG_FIT_EXTERNAL_OFFSET=0x1000
CONFIG_FIT_CIPHER=y
CONFIG_FIT_VERBOSE=y
CONFIG_FIT_BEST_MATCH=y
CONFIG_SPL_FIT_PRINT=y
CONFIG_SPL_FIT_FULL_CHECK=y
# CONFIG_SPL_FIT_SIGNATURE is not set
CONFIG_SPL_LOAD_FIT_ADDRESS=0x10000000
CONFIG_SPL_FIT_IMAGE_POST_PROCESS=y
CONFIG_SPL_FIT_IMAGE_KB=2048
CONFIG_BOOTDELAY=0
CONFIG_DEFAULT_FDT_FILE="rockchip/rk3576-evb.dtb"
# CONFIG_CONSOLE_MUX is not set
# CONFIG_DISPLAY_CPUINFO is not set
CONFIG_DISPLAY_BOARDINFO_LATE=y
# CONFIG_CYCLIC is not set
CONFIG_LAST_STAGE_INIT=y
# CONFIG_MISC_INIT_R is not set
CONFIG_AVB_VERIFY=y
CONFIG_AVB_BUF_ADDR=0x42000000
CONFIG_AVB_BUF_SIZE=0x2000000
CONFIG_BOARD_RNG_SEED=y
CONFIG_SPL_MAX_SIZE=0x80000
CONFIG_SPL_PAD_TO=0x7f8000
# CONFIG_SPL_SKIP_RELOCATE is not set
CONFIG_SPL_RELOC_TEXT_BASE=0x43d00000
# CONFIG_SPL_RAW_IMAGE_SUPPORT is not set
CONFIG_SYS_MMCSD_RAW_MODE_U_BOOT_USE_PARTITION=y
CONFIG_SYS_MMCSD_RAW_MODE_U_BOOT_PARTITION=0x1
CONFIG_SPL_CRYPTO=y
CONFIG_SPL_MTD=y
CONFIG_SPL_UFS=y
CONFIG_SPL_DM_RESET=y
CONFIG_SPL_RESET_ROCKCHIP=y
# CONFIG_SPL_SPI_FLASH_TINY is not set
CONFIG_SPL_SPI_FLASH_MTD=y
CONFIG_SPL_AB=y
CONFIG_CMD_GPIO=y
CONFIG_CMD_GPT=y
CONFIG_CMD_MMC=y
CONFIG_CMD_UFS=y
CONFIG_CMD_USB=y
CONFIG_CMD_USB_MASS_STORAGE=y
# CONFIG_CMD_SETEXPR is not set
# CONFIG_CMD_MDIO is not set
# CONFIG_CMD_CLS is not set
CONFIG_CMD_REGULATOR=y
# CONFIG_SPL_DOS_PARTITION is not set
CONFIG_EFI_PARTITION_ENTRIES_NUMBERS=64
CONFIG_OF_SPL_REMOVE_PROPS="clock-names interrupt-parent assigned-clocks assigned-clock-rates assigned-clock-parents"
CONFIG_OF_DTB_PROPS_REMOVE=y
CONFIG_OF_REMOVE_PROPS="clock-names interrupt-parent assigned-clocks assigned-clock-rates assigned-clock-parents pinctrl-0 pinctrl-names"
CONFIG_SYS_REDUNDAND_ENVIRONMENT=y
CONFIG_SARADC_ROCKCHIP_V2=y
CONFIG_BUTTON=y
CONFIG_BUTTON_ADC=y
CONFIG_BUTTON_GPIO=y
CONFIG_CLK_SCMI=y
CONFIG_CRYPTO_MANAGER=y
CONFIG_DM_HASH=y
CONFIG_HASH_SOFTWARE=y
# CONFIG_ROCKCHIP_RSA is not set
CONFIG_ROCKCHIP_CIPHER=y
CONFIG_ROCKCHIP_HMAC=y
CONFIG_ROCKCHIP_CRYPTO_V2=y
# CONFIG_USB_FUNCTION_FASTBOOT is not set
CONFIG_SCMI_FIRMWARE=y
CONFIG_ROCKCHIP_GPIO=y
# CONFIG_SPL_DM_I2C is not set
CONFIG_SYS_I2C_ROCKCHIP=y
CONFIG_MISC_DECOMPRESS=y
CONFIG_SPL_MISC_DECOMPRESS=y
CONFIG_ROCKCHIP_HW_DECOMPRESS=y
CONFIG_SPL_ROCKCHIP_HW_DECOMPRESS=y
CONFIG_ROCKCHIP_SECURE_OTP=y
CONFIG_SPL_ROCKCHIP_SECURE_OTP=y
CONFIG_SUPPORT_EMMC_RPMB=y
CONFIG_MMC_HS400_ES_SUPPORT=y
CONFIG_SPL_MMC_HS400_ES_SUPPORT=y
CONFIG_MMC_HS400_SUPPORT=y
CONFIG_SPL_MMC_HS400_SUPPORT=y
CONFIG_MMC_DW=y
CONFIG_MMC_DW_ROCKCHIP=y
CONFIG_MMC_SDHCI=y
CONFIG_MMC_SDHCI_SDMA=y
CONFIG_MMC_SDHCI_ROCKCHIP=y
CONFIG_DM_MTD=y
CONFIG_MTD_BLK=y
CONFIG_MTD_SPI_NAND=y
CONFIG_PHYLIB=y
CONFIG_PHY_REALTEK=y
CONFIG_PHY_ROCKCHIP_INNO_USB2=y
CONFIG_PHY_ROCKCHIP_NANENG_COMBOPHY=y
CONFIG_PHY_ROCKCHIP_SAMSUNG_HDPTX=y
CONFIG_PHY_ROCKCHIP_USBDP=y
CONFIG_DM_FUEL_GAUGE=y
CONFIG_POWER_FG_CW201X=y
CONFIG_POWER_FG_CW221X=y
CONFIG_DM_PMIC=y
# CONFIG_SPL_DM_PMIC is not set
CONFIG_PMIC_RK8XX=y
CONFIG_REGULATOR_PWM=y
CONFIG_DM_REGULATOR_GPIO=y
CONFIG_REGULATOR_RK8XX=y
CONFIG_PWM_ROCKCHIP=y
CONFIG_SCSI=y
CONFIG_BAUDRATE=1500000
CONFIG_DEBUG_UART_SHIFT=2
CONFIG_SYS_NS16550_MEM32=y
CONFIG_ROCKCHIP_SFC=y
CONFIG_ROCKCHIP_SPI=y
CONFIG_SYSRESET_PSCI=y
CONFIG_TEE=y
CONFIG_OPTEE=y
CONFIG_ROCKCHIP_OPTEE_V2=y
CONFIG_USB=y
# CONFIG_SPL_DM_USB is not set
CONFIG_USB_XHCI_HCD=y
CONFIG_USB_EHCI_HCD=y
CONFIG_USB_EHCI_GENERIC=y
CONFIG_USB_OHCI_HCD=y
CONFIG_USB_OHCI_GENERIC=y
CONFIG_USB_DWC3=y
CONFIG_USB_DWC3_GENERIC=y
CONFIG_USB_GADGET=y
CONFIG_USB_GADGET_DOWNLOAD=y
CONFIG_USB_FUNCTION_ROCKUSB=y
CONFIG_UFS=y
CONFIG_ROCKCHIP_UFS=y
CONFIG_VIDEO=y
CONFIG_DISPLAY=y
CONFIG_DRM_ROCKCHIP=y
CONFIG_DRM_ROCKCHIP_DW_HDMI_QP=y
CONFIG_DRM_ROCKCHIP_DW_MIPI_DSI2=y
CONFIG_DRM_ROCKCHIP_DW_DP=y
CONFIG_DRM_ROCKCHIP_ANALOGIX_DP=y
CONFIG_DRM_ROCKCHIP_RGB=y
CONFIG_DRM_ROCKCHIP_SAMSUNG_MIPI_DCPHY=y
CONFIG_PHY_ROCKCHIP_SAMSUNG_HDPTX_HDMI=y
CONFIG_RSA=y
CONFIG_SPL_RSA=y
CONFIG_RSA_N_SIZE=0x200
CONFIG_RSA_E_SIZE=0x10
CONFIG_RSA_C_SIZE=0x20
CONFIG_XBC=y
CONFIG_LIBAVB=y
CONFIG_LIBAVB_AB=y
CONFIG_SPL_GZIP=y
CONFIG_ERRNO_STR=y
CONFIG_OPTEE_ALWAYS_USE_SECURITY_PARTITION=y
```

## configs/rk3588-usbplug_defconfig
```kconfig
CONFIG_ARM=y
CONFIG_SKIP_LOWLEVEL_INIT=y
CONFIG_COUNTER_FREQUENCY=24000000
CONFIG_ARCH_ROCKCHIP=y
CONFIG_TEXT_BASE=0x00000000
CONFIG_SYS_MALLOC_F_LEN=0x10000
CONFIG_CUSTOM_SYS_INIT_SP_ADDR=0x00600000
CONFIG_DEFAULT_DEVICE_TREE="rockchip/rk3588-evb"
CONFIG_ROCKCHIP_RK3588=y
CONFIG_ROCKCHIP_NEW_IDB=y
# CONFIG_ROCKCHIP_FIT_IMAGE is not set
CONFIG_ROCKCHIP_LOWLEVEL_INIT=y
CONFIG_SPL_DRIVERS_MISC=y
CONFIG_SPL_STACK_R_ADDR=0x03e00000
CONFIG_TARGET_EVB_RK3588=y
CONFIG_SPL_SYS_MALLOC_F_LEN=0x100000
CONFIG_SPL_TEXT_BASE=0x00000000
CONFIG_SPL_BSS_START_ADDR=0x03fe0000
CONFIG_SPL_BSS_MAX_SIZE=0x00010000
CONFIG_SPL_STACK_R=y
CONFIG_SYS_LOAD_ADDR=0xc00800
CONFIG_DEBUG_UART_BASE=0xfeb50000
CONFIG_DEBUG_UART_CLOCK=24000000
CONFIG_SPL_LIBDISK_SUPPORT=y
# CONFIG_ARMV8_SET_SMPEN is not set
CONFIG_BUILD_TARGET=""
CONFIG_DEBUG_UART=y
# CONFIG_EFI_LOADER is not set
# CONFIG_ANDROID_BOOT_IMAGE is not set
# CONFIG_BUTTON_CMD is not set
# CONFIG_ANDROID_BOOT_IMAGE_HASH is not set
# CONFIG_FIT_EXTERNAL_OFFSET is not set
# CONFIG_FIT_CIPHER is not set
# CONFIG_FIT_VERBOSE is not set
# CONFIG_FIT_BEST_MATCH is not set
# CONFIG_SPL_FIT_PRINT is not set
# CONFIG_SPL_FIT_FULL_CHECK is not set
# CONFIG_SPL_FIT_SIGNATURE is not set
# CONFIG_SPL_LOAD_FIT_ADDRESS is not set
CONFIG_BOOTDELAY=0
CONFIG_DEFAULT_FDT_FILE="rockchip/rk3588-evb.dtb"
# CONFIG_CONSOLE_MUX is not set
# CONFIG_DISPLAY_CPUINFO is not set
# CONFIG_DISPLAY_BOARDINFO_LATE is not set
# CONFIG_CYCLIC is not set
# CONFIG_LAST_STAGE_INIT is not set
# CONFIG_MISC_INIT_R is not set
# CONFIG_AVB_VERIFY is not set
# CONFIG_AVB_BUF_ADDR is not set
# CONFIG_AVB_BUF_SIZE is not set
CONFIG_SPL_MAX_SIZE=0x80000
CONFIG_SPL_PAD_TO=0x7f8000
# CONFIG_SPL_SKIP_RELOCATE is not set
CONFIG_SPL_RELOC_TEXT_BASE=0x03d00000
# CONFIG_SPL_RAW_IMAGE_SUPPORT is not set
# CONFIG_CMD_CRYPTO is not set
# CONFIG_CMD_GPIO is not set
# CONFIG_CMD_GPT is not set
# CONFIG_CMD_MMC is not set
# CONFIG_CMD_UFS is not set
# CONFIG_CMD_USB is not set
# CONFIG_CMD_BDI is not set
# CONFIG_CMD_ITEST is not set
CONFIG_CMD_USB_MASS_STORAGE=y
# CONFIG_CMD_SETEXPR is not set
# CONFIG_CMD_MDIO is not set
# CONFIG_CMD_CLS is not set
# CONFIG_CMD_REGULATOR is not set
# CONFIG_SPL_DOS_PARTITION is not set
CONFIG_OF_DTB_PROPS_REMOVE=y
CONFIG_OF_REMOVE_PROPS="clock-names interrupt-parent assigned-clocks assigned-clock-rates assigned-clock-parents pinctrl-0 pinctrl-names"
CONFIG_SYS_REDUNDAND_ENVIRONMENT=y
# CONFIG_SARADC_ROCKCHIP is not set
# CONFIG_SARADC_ROCKCHIP_V2 is not set
# CONFIG_BUTTON is not set
# CONFIG_BUTTON_ADC is not set
# CONFIG_BUTTON_GPIO is not set
# CONFIG_CLK_SCMI is not set
# CONFIG_CRYPTO_MANAGER is not set
# CONFIG_DM_HASH is not set
# CONFIG_ROCKCHIP_CIPHER is not set
# CONFIG_ROCKCHIP_HMAC is not set
# CONFIG_ROCKCHIP_CRYPTO_V2 is not set
# CONFIG_USB_FUNCTION_FASTBOOT is not set
# CONFIG_SCMI_FIRMWARE is not set
# CONFIG_ROCKCHIP_GPIO is not set
# CONFIG_SYS_I2C_ROCKCHIP is not set
CONFIG_MMC_HS400_ES_SUPPORT=y
CONFIG_MMC_HS400_SUPPORT=y
CONFIG_MMC_SDHCI=y
CONFIG_MMC_SDHCI_SDMA=y
CONFIG_MMC_SDHCI_ROCKCHIP=y
CONFIG_PHYLIB=y
# CONFIG_PHY_REALTEK is not set
CONFIG_PHY_ROCKCHIP_INNO_USB2=y
# CONFIG_PHY_ROCKCHIP_NANENG_COMBOPHY is not set
# CONFIG_PHY_ROCKCHIP_SAMSUNG_HDPTX is not set
CONFIG_PHY_ROCKCHIP_USBDP=y
CONFIG_OF_LIVE=y
# CONFIG_DM_PMIC is not set
# CONFIG_SPL_DM_PMIC is not set
# CONFIG_PMIC_RK8XX is not set
# CONFIG_REGULATOR_PWM is not set
# CONFIG_DM_REGULATOR_GPIO is not set
# CONFIG_REGULATOR_RK8XX is not set
# CONFIG_PWM_ROCKCHIP is not set
CONFIG_SCSI=y
CONFIG_BAUDRATE=1500000
CONFIG_DEBUG_UART_SHIFT=2
# CONFIG_SYS_NS16550_MEM32 is not set
# CONFIG_ROCKCHIP_SPI is not set
CONFIG_SYSRESET_PSCI=y
# CONFIG_TEE is not set
# CONFIG_OPTEE is not set
# CONFIG_ROCKCHIP_OPTEE_V2 is not set
CONFIG_USB=y
CONFIG_USB_XHCI_HCD=y
CONFIG_USB_EHCI_HCD=y
CONFIG_USB_EHCI_GENERIC=y
# CONFIG_USB_OHCI_HCD is not set
# CONFIG_USB_OHCI_GENERIC is not set
CONFIG_USB_DWC3=y
CONFIG_USB_DWC3_GENERIC=y
CONFIG_USB_GADGET=y
CONFIG_USB_GADGET_DOWNLOAD=y
CONFIG_USB_FUNCTION_ROCKUSB=y
# CONFIG_USB_HOST is not set
CONFIG_UFS=y
CONFIG_ROCKCHIP_UFS=y
CONFIG_RSA=y
CONFIG_SPL_RSA=y
CONFIG_RSA_N_SIZE=0x100
CONFIG_RSA_E_SIZE=0x200
CONFIG_RSA_C_SIZE=0x80
# CONFIG_X509_CERTIFICATE_PARSER is not set
# CONFIG_XBC is not set
# CONFIG_LIBAVB is not set
# CONFIG_LIBAVB_AB is not set
CONFIG_ERRNO_STR=y
CONFIG_SUPPORT_USBPLUG=y
CONFIG_ROCKCHIP_EMMC_IOMUX=y
CONFIG_INIT_SP_RELATIVE=y
# CONFIG_CMD_BOOTM is not set
# CONFIG_CMD_BOOTD is not set
# CONFIG_BOOTSTD is not set
# CONFIG_CMD_BOOT_ANDROID is not set
# CONFIG_ANDROID_BOOT_IMAGE is not set
# CONFIG_CMD_BOOTI is not set
# CONFIG_CMD_ELF is not set
# CONFIG_CMD_NET is not set
# CONFIG_CMD_LOADS is not set
# CONFIG_CMD_XIMG is not set
# CONFIG_CMD_IDE is not set
# CONFIG_CMD_SOURCE is not set
CONFIG_COUNTER_FREQUENCY=0
```

## drivers/clk/rockchip/Kconfig
```kconfig
config ROCKCHIP_CLK_PLL
	bool "Rockchip PLL clock drivers"
	depends on CLK
	default y if !ROCKCHIP_IMAGE_TINY
	help
	  Enable support for pll clocks on Rockchip SoCs.

config ROCKCHIP_CLK_DCLK_MOS
	bool "Rockchip clock dclk mos drivers"
	depends on CLK
	help
	  Enable support for dclk mos on Rockchip SoCs
```

## drivers/cpu/Kconfig
```kconfig
config CPU
	bool "Enable CPU drivers using Driver Model"
	help
	  This allows drivers to be provided for CPUs and their type to be
	  specified in the board's device tree. For boards which support
	  multiple CPUs, then normally have to be set up in U-Boot so that
	  they can work correctly in the OS. This provides a framework for
	  finding out information about available CPUs and making changes.

config CPU_IMX
	bool "Enable i.MX CPU driver"
	depends on CPU && ARM64
	help
	  Support CPU cores for SoCs of the i.MX series.

config CPU_MPC83XX
	bool "Enable MPC83xx CPU driver"
	depends on CPU && MPC83xx
	select CLK_MPC83XX
	help
	  Support CPU cores for SoCs of the MPC83xx series.

config CPU_RISCV
	bool "Enable RISC-V CPU driver"
	depends on CPU && RISCV
	help
	  Support CPU cores for RISC-V architecture.

config CPU_ARMV8
	bool "Enable generic ARMv8 CPU driver"
	depends on CPU && ARM64
	imply IRQ
	help
	  Support CPU cores for armv8 architecture.

config CPU_MICROBLAZE
	bool "Enable Microblaze CPU driver"
	depends on CPU && MICROBLAZE
	select DM_EVENT
	select XILINX_MICROBLAZE0_PVR
	help
	  Support CPU cores for Microblaze architecture.

config CPU_XTENSA
	bool "Enable Xtensa CPU driver"
	depends on CPU && XTENSA
	help
	  Support CPU cores for Xtensa architecture.

config AMP
	bool "Enable AMP drivers using Driver Model"
	depends on CPU
	help
	  This support Asymmetric Multi-Processing, cpus can run on different
	  firmware.

config ROCKCHIP_AMP
	bool "Enable Rockchip AMP driver"
	depends on AMP
	help
	  This enable Rockchip AMP driver support.
```

## drivers/crypto/Kconfig
```kconfig
menu "Hardware crypto devices"

config CRYPTO_MANAGER
	bool "Enable Crypto Manager driver as crypto framework for hardware crypto"
	depends on DM
	help
	  If you want to use driver model for RSA Modular Exponentiation, say Y.

config SPL_CRYPTO_MANAGER
	bool "Enable Crypto Manager driver as crypto framework for hardware crypto in SPL"
	depends on SPL_DM && SPL_CRYPTO
	help
	  If you want to use driver model for RSA Modular Exponentiation, say Y.

source "drivers/crypto/cipher/Kconfig"

source "drivers/crypto/hash/Kconfig"

source "drivers/crypto/hmac/Kconfig"

source "drivers/crypto/fsl/Kconfig"

source "drivers/crypto/aspeed/Kconfig"

source "drivers/crypto/nuvoton/Kconfig"

source drivers/crypto/rockchip/Kconfig

endmenu
```

## drivers/crypto/cipher/Kconfig
```kconfig
config DM_CIPHER
	bool "Enable Driver Model for Cipher"
	depends on DM
	help
	  If you want to use driver model for Cipher, say Y.
```

## drivers/crypto/hmac/Kconfig
```kconfig
config DM_HMAC
	bool "Enable Driver Model for Hmac"
	depends on DM
	help
	  If you want to use driver model for Hmac, say Y.
```
