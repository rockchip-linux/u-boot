/*
 * (C) 2017 Theobroma Systems Design und Consulting GmbH
 *
 * SPDX-License-Identifier:     GPL-2.0+
 */

&dmc {
	rockchip,sdram-params = <
		0x1
		0xC
		0x3
		0x1
		0x0
		0x0
		0x10
		0x10
		0

		0x9c89d51e
		0x00000000
		0x00000031
		0x00000575
		0x00000015
		0x0000053a
		0x000000ff

		933
		6
		1

		0x00000000
		0x43041008
		0x00000064
		0x00380062
		0x000000d0
		0x005d0002
		0x000000d4
		0x00010000
		0x000000d8
		0x00001003
		0x000000dc
		0x0083001c
		0x000000e0
		0x00010000
		0x000000e4
		0x00100006
		0x000000f4
		0x000f011f
		0x00000100
		0x0d181f14
		0x00000104
		0x0004031e
		0x00000108
		0x0407090a
		0x0000010c
		0x00707000
		0x00000110
		0x0902050b
		0x00000114
		0x01010707
		0x00000118
		0x02020005
		0x00000120
		0x00000505
		0x00000138
		0x00000067
		0x00000180
		0x00a8002a
		0x00000184
		0x01800000
		0x00000190
		0x07060003
		0x00000198
		0x05001100
		0x000001a0
		0xc0400003
		0x00000240
		0x0b030d2c
		0x00000244
		0x00000101
		0x00000250
		0x00000f00
		0x00000490
		0x00000001
		0xffffffff
		0xffffffff
		0xffffffff
		0xffffffff
		0xffffffff
		0xffffffff

		0x00000004
		0x0000000b
		0x00000028
		0x0000000e
		0x0000002c
		0x00000000
		0x00000030
		0x00000008
		0xffffffff
		0xffffffff

		0x77
		0x88
		0x79
		0x79
		0x87
		0x97
		0x87
		0x78
		0x77
		0x78
		0x87
		0x88
		0x87
		0x87
		0x77

		0x78
		0x78
		0x78
		0x78
		0x78
		0x78
		0x78
		0x78
		0x78
		0x69
		0x9

		0x77
		0x78
		0x77
		0x78
		0x77
		0x78
		0x77
		0x78
		0x77
		0x79
		0x9

		0x78
		0x78
		0x78
		0x78
		0x78
		0x78
		0x78
		0x78
		0x78
		0x69
		0x9

		0x77
		0x78
		0x77
		0x77
		0x77
		0x77
		0x77
		0x77
		0x77
		0x79
		0x9

		0x78
		0x78
		0x78
		0x78
		0x78
		0x78
		0x78
		0x78
		0x78
		0x69
		0x9

		0x77
		0x78
		0x77
		0x78
		0x77
		0x78
		0x77
		0x78
		0x77
		0x79
		0x9

		0x78
		0x78
		0x78
		0x78
		0x78
		0x78
		0x78
		0x78
		0x78
		0x69
		0x9

		0x77
		0x78
		0x77
		0x77
		0x77
		0x77
		0x77
		0x77
		0x77
		0x79
		0x9
	>;
};
