## arch/arm/cpu/armv7/rk32xx/Kconfig
```kconfig
if ROCKCHIP_ARCH32

config ROCKCHIP
	bool

choice
	prompt "rockchip platform select"

config PLAT_RK32XX
	bool "rk32xx platform"
	select ROCKCHIP

config PLAT_RK30XX
	bool "rk30xx platform"
	select ROCKCHIP

endchoice


config SYS_CPU
	default "armv7"

config SYS_SOC
	default "rk32xx"

source "board/rockchip/rk32xx/Kconfig"

source "board/rockchip/common/Kconfig"

endif
```

## arch/arm/cpu/armv8/Kconfig
```kconfig
if ARM64

config SYS_CPU
	default "armv8"

config ARMV8_MULTIENTRY
        boolean "Enable multiple CPUs to enter into U-boot"

endif
```

## arch/arm/cpu/armv8/rk33xx/Kconfig
```kconfig
if ROCKCHIP_ARCH64

config ROCKCHIP
	bool

choice
	prompt "rockchip platform select"

config PLAT_RK33XX
	bool "rk33xx platform"
	select ROCKCHIP

endchoice


config SYS_CPU
	default "armv8"

config SYS_SOC
	default "rk33xx"

source "board/rockchip/rk33xx/Kconfig"

source "board/rockchip/common/Kconfig"

endif
```

## arch/arm/mach-rockchip/Kconfig
```kconfig
if ARCH_ROCKCHIP

config ROCKCHIP_RK3036
	bool "Support Rockchip RK3036"
	select CPU_V7
	select SUPPORT_SPL
	select SPL
	help
	  The Rockchip RK3036 is a ARM-based SoC with a dual-core Cortex-A7
	  including NEON and GPU, Mali-400 graphics, several DDR3 options
	  and video codec support. Peripherals include Gigabit Ethernet,
	  USB2 host and OTG, SDIO, I2S, UART, SPI, I2C and PWMs.

config ROCKCHIP_RK3128
	bool "Support Rockchip RK3128"
	select CPU_V7
	select GICV2
	select ARM_SMCCC
	help
	  The Rockchip RK3128 is a ARM-based SoC with a quad-core Cortex-A7
	  including NEON and GPU, Mali-400 graphics, several DDR3 options
	  and video codec support. Peripherals include Gigabit Ethernet,
	  USB2 host and OTG, SDIO, I2S, UART, SPI, I2C and PWMs.

if ROCKCHIP_RK3128

config ROCKCHIP_RK3126
	bool "Support Rockchip RK3126 "
	help
	  RK3126 can use most code from RK3128, but at some situations we have
	  to distinguish between RK3126 and RK3128, so this macro gives help.
	  It is usually selected in rk3126 board defconfig.
endif

config ROCKCHIP_RK3066
	bool "Support Rockchip RK3066"
	select CPU_V7
	select SUPPORT_SPL
	select SUPPORT_TPL
	select SPL
	select TPL
	select BOARD_LATE_INIT
	select ROCKCHIP_BROM_HELPER
	help
	  The Rockchip RK3066 is a ARM-based SoC with a dual-core Cortex-A9
	  including NEON and GPU, Mali-400 graphics, several DDR3 options
	  and video codec support. Peripherals include ethernet, USB2 host
	  and OTG, SDIO, I2S, UART, SPI, I2C and PWMs.

config ROCKCHIP_RK3188
	bool "Support Rockchip RK3188"
	select CPU_V7
	select SPL_BOARD_INIT if SPL
	select SUPPORT_SPL
	select SPL
	select SPL_CLK
	select SPL_PINCTRL
	select SPL_REGMAP
	select SPL_SYSCON
	select SPL_RAM
	select SPL_DRIVERS_MISC_SUPPORT
	select SPL_ROCKCHIP_EARLYRETURN_TO_BROM
	select BOARD_LATE_INIT
	select ROCKCHIP_BROM_HELPER
	help
	  The Rockchip RK3188 is a ARM-based SoC with a quad-core Cortex-A9
	  including NEON and GPU, 512KB L2 cache, Mali-400 graphics, two
	  video interfaces, several memory options and video codec support.
	  Peripherals include Fast Ethernet, USB2 host and OTG, SDIO, I2S,
	  UART, SPI, I2C and PWMs.

config ROCKCHIP_RK322X
	bool "Support Rockchip RK3228/RK3229"
	select CPU_V7
	select SUPPORT_SPL
	select SUPPORT_TPL
	select SPL
	select TPL
	select TPL_NEEDS_SEPARATE_TEXT_BASE if SPL
	select TPL_NEEDS_SEPARATE_STACK if TPL
	select SPL_DRIVERS_MISC_SUPPORT
	imply SPL_SERIAL_SUPPORT
	imply TPL_SERIAL_SUPPORT
	select ROCKCHIP_BROM_HELPER
	select DEBUG_UART_BOARD_INIT
	select TPL_LIBCOMMON_SUPPORT
	select TPL_LIBGENERIC_SUPPORT
	select GICV2
	help
	  The Rockchip RK3229 is a ARM-based SoC with a dual-core Cortex-A7
	  including NEON and GPU, Mali-400 graphics, several DDR3 options
	  and video codec support. Peripherals include Gigabit Ethernet,
	  USB2 host and OTG, SDIO, I2S, UART, SPI, I2C and PWMs.

config ROCKCHIP_RK3288
	bool "Support Rockchip RK3288"
	select CPU_V7
	select SPL_BOARD_INIT if SPL
	select SUPPORT_SPL
	select SPL
	select GICV2
	help
	  The Rockchip RK3288 is a ARM-based SoC with a quad-core Cortex-A17
	  including NEON and GPU, 1MB L2 cache, Mali-T7 graphics, two
	  video interfaces supporting HDMI and eDP, several DDR3 options
	  and video codec support. Peripherals include Gigabit Ethernet,
	  USB2 host and OTG, SDIO, I2S, UARTs, SPI, I2C and PWMs.

config ROCKCHIP_RK3328
	bool "Support Rockchip RK3328"
	select ARM64
	select GICV2
	select SUPPORT_SPL
	select SUPPORT_TPL
	select SPL
	select TPL
	select TPL_NEEDS_SEPARATE_TEXT_BASE if TPL
	select TPL_NEEDS_SEPARATE_STACK if TPL
	imply SPL_SERIAL_SUPPORT
	imply TPL_SERIAL_SUPPORT
	imply SPL_SEPARATE_BSS
	select ENABLE_ARM_SOC_BOOT0_HOOK
	select DEBUG_UART_BOARD_INIT
	select SYS_NS16550
	help
	  The Rockchip RK3328 is a ARM-based SoC with a quad-core Cortex-A53.
	  including NEON and GPU, 1MB L2 cache, Mali-T7 graphics, two
	  video interfaces supporting HDMI and eDP, several DDR3 options
	  and video codec support. Peripherals include Gigabit Ethernet,
	  USB2 host and OTG, SDIO, I2S, UARTs, SPI, I2C and PWMs.

if ROCKCHIP_RK3328

config TPL_LDSCRIPT
	default "arch/arm/mach-rockchip/u-boot-tpl-v8.lds"

config TPL_TEXT_BASE
        default 0xff091000

config TPL_MAX_SIZE
        default 28672

config TPL_STACK
        default 0xff098000

endif

config ROCKCHIP_RK3368
	bool "Support Rockchip RK3368"
	select ARM64
	select SUPPORT_SPL
	select SUPPORT_TPL
	select TPL_NEEDS_SEPARATE_TEXT_BASE if SPL
	select TPL_NEEDS_SEPARATE_STACK if TPL
	imply SPL_SEPARATE_BSS
	imply SPL_SERIAL_SUPPORT
	imply TPL_SERIAL_SUPPORT
	select DEBUG_UART_BOARD_INIT
	select SYS_NS16550
	select GICV2
	help
	  The Rockchip RK3368 is a ARM-based SoC with a octa-core (organised
	  into a big and little cluster with 4 cores each) Cortex-A53 including
	  AdvSIMD, 512KB L2 cache (for the big cluster) and 256 KB L2 cache
	  (for the little cluster), PowerVR G6110 based graphics, one video
	  output processor supporting LVDS/HDMI/eDP, several DDR3 options and
	  video codec support.

	  On-chip peripherals include Gigabit Ethernet, USB2 host and OTG, SDIO,
	  I2S, UARTs, SPI, I2C and PWMs.

if ROCKCHIP_RK3368

config TPL_LDSCRIPT
	default "arch/arm/mach-rockchip/rk3368/u-boot-tpl.lds"

config TPL_TEXT_BASE
        default 0xff8c1000

config TPL_MAX_SIZE
        default 28672

config TPL_STACK
        default 0xff8cffff

endif

config ROCKCHIP_RK3399
	bool "Support Rockchip RK3399"
	select ARM64
	select SUPPORT_SPL
	select SPL
	select SPL_SEPARATE_BSS
	select SPL_SERIAL_SUPPORT
	select SPL_DRIVERS_MISC_SUPPORT
	select DEBUG_UART_BOARD_INIT
	select GICV3
	select BOARD_LATE_INIT
	select ROCKCHIP_BROM_HELPER
	help
	  The Rockchip RK3399 is a ARM-based SoC with a dual-core Cortex-A72
	  and quad-core Cortex-A53.
	  including NEON and GPU, 1MB L2 cache, Mali-T7 graphics, two
	  video interfaces supporting HDMI and eDP, several DDR3 options
	  and video codec support. Peripherals include Gigabit Ethernet,
	  USB2 host and OTG, SDIO, I2S, UARTs, SPI, I2C and PWMs.

config ROCKCHIP_RV1108
	bool "Support Rockchip RV1108"
	select CPU_V7
	help
	  The Rockchip RV1108 is a ARM-based SoC with a single-core Cortex-A7
	  and a DSP.

config SPL_ROCKCHIP_BACK_TO_BROM
	bool "SPL returns to bootrom"
	default y if ROCKCHIP_RK3036
	select ROCKCHIP_BROM_HELPER
	depends on SPL
	help
	  Rockchip SoCs have ability to load SPL & U-Boot binary. If enabled,
          SPL will return to the boot rom, which will then load the U-Boot
          binary to keep going on.

config TPL_ROCKCHIP_BACK_TO_BROM
	bool "TPL returns to bootrom"
	default y if ROCKCHIP_RK3368 || ROCKCHIP_RK3328
	select ROCKCHIP_BROM_HELPER
	depends on TPL
	help
	  Rockchip SoCs have ability to load SPL & U-Boot binary. If enabled,
          SPL will return to the boot rom, which will then load the U-Boot
          binary to keep going on.

config ROCKCHIP_BOOT_MODE_REG
	hex "Rockchip boot mode flag register address"
	default 0x200081c8 if ROCKCHIP_RK3036
	default 0x100a0038 if ROCKCHIP_RK3128
	default 0x20004040 if ROCKCHIP_RK3188
	default 0x110005c8 if ROCKCHIP_RK322X
	default 0xff730094 if ROCKCHIP_RK3288
	default 0xff738200 if ROCKCHIP_RK3368
	default 0xff320300 if ROCKCHIP_RK3399
	default 0x10300580 if ROCKCHIP_RV1108
	default 0
	help
	  The Soc will enter to different boot mode(defined in asm/arch/boot_mode.h)
	  according to the value from this register.

config ROCKCHIP_SPL_RESERVE_IRAM
	hex "Size of IRAM reserved in SPL"
	default 0x4000
	help
	  SPL may need reserve memory for firmware loaded by SPL, whose load
	  address is in IRAM and may overlay with SPL text area if not
	  reserved.

config ROCKCHIP_BROM_HELPER
	bool

config SPL_ROCKCHIP_EARLYRETURN_TO_BROM
        bool "SPL requires early-return (for RK3188-style BROM) to BROM"
	depends on SPL && ENABLE_ARM_SOC_BOOT0_HOOK
	help
	  Some Rockchip BROM variants (e.g. on the RK3188) load the
	  first stage in segments and enter multiple times. E.g. on
	  the RK3188, the first 1KB of the first stage are loaded
	  first and entered; after returning to the BROM, the
	  remainder of the first stage is loaded, but the BROM
	  re-enters at the same address/to the same code as previously.

	  This enables support code in the BOOT0 hook for the SPL stage
	  to allow multiple entries.

config TPL_ROCKCHIP_EARLYRETURN_TO_BROM
        bool "TPL requires early-return (for RK3188-style BROM) to BROM"
	depends on TPL && ENABLE_ARM_SOC_BOOT0_HOOK
	help
	  Some Rockchip BROM variants (e.g. on the RK3188) load the
	  first stage in segments and enter multiple times. E.g. on
	  the RK3188, the first 1KB of the first stage are loaded
	  first and entered; after returning to the BROM, the
	  remainder of the first stage is loaded, but the BROM
	  re-enters at the same address/to the same code as previously.

	  This enables support code in the BOOT0 hook for the TPL stage
	  to allow multiple entries.

config SPL_MMC_SUPPORT
	default y if !SPL_ROCKCHIP_BACK_TO_BROM

config RKIMG_BOOTLOADER
	bool "Support for Rockchip Image Bootloader boot flow"
	default n
	help
	  Rockchip use this to boot Android during development cycle and for
	  other OS, typical content kernel.img with zImage/Image, boot.img and
	  recovery.img with Ramdisk, packed with 'KNRL' header; and resource.img
	  with dtb and uboot/kernel logo bmp, vendor storage for custom info
	  like SN and MAC address.

config ROCKCHIP_RESOURCE_IMAGE
	bool "Enable support for rockchip resource image"
	depends on RKIMG_BOOTLOADER
	help
	  This enables support to get dtb or logo files from
	  rockchip resource image format partition.

config ROCKCHIP_VENDOR_PARTITION
	bool "Rockchip vendor storage partition support"
	depends on RKIMG_BOOTLOADER
	help
	  This enable support to read/write vendor configuration data from/to
	  this partition.

config ROCKCHIP_CRC
	bool "Rockchip CRC verify images"
	help
	  This enable support Rockchip CRC verify images. It takes a lot of time,
	  so it is better only used for debug.

config ROCKCHIP_SMCCC
	bool "Rockchip SMCCC"
	default y if ARM_SMCCC
	help
	  This enable support for Rockchip SMC calls

config GICV2
	bool "ARM GICv2"

config GICV3
	bool "ARM GICv3"

source "arch/arm/mach-rockchip/rk3036/Kconfig"
source "arch/arm/mach-rockchip/rk3066/Kconfig"
source "arch/arm/mach-rockchip/rk3128/Kconfig"
source "arch/arm/mach-rockchip/rk3188/Kconfig"
source "arch/arm/mach-rockchip/rk322x/Kconfig"
source "arch/arm/mach-rockchip/rk3288/Kconfig"
source "arch/arm/mach-rockchip/rk3328/Kconfig"
source "arch/arm/mach-rockchip/rk3368/Kconfig"
source "arch/arm/mach-rockchip/rk3399/Kconfig"
source "arch/arm/mach-rockchip/rv1108/Kconfig"
endif
```

## arch/arm/mach-rockchip/rk3328/Kconfig
```kconfig
if ROCKCHIP_RK3328

choice
	prompt "RK3328 board select"

config TARGET_EVB_RK3328
	bool "RK3328 evaluation board"
	help
	  RK3328evb is a evaluation board for Rockchip rk3328,
	  with full function and phisical connectors support like
	  usb2.0 host ports, LVDS, JTAG, MAC, SDcard, HDMI, USB-2-serial...

config TARGET_ROCK64_RK3328
	bool "ROCK64 RK3328"
	help
	  ROCK64 is a credit card size 4K60P HDR Media Board Computer
	  powered by Rockchip RK3328 Quad-Core ARM Cortex A53 64-Bit Processor
	  and support up to 4GB 1600MHz LPDDR3 memory.
	  It provides eMMC module socket, MicroSD Card slot, Pi-2 Bus, Pi-P5+ Bus,
	  USB 3.0 and many others peripheral devices interface for makers
	  to integrate with sensors and devices

endchoice

config SYS_SOC
	default "rockchip"

config SYS_MALLOC_F_LEN
	default 0x0800

source "board/rockchip/evb_rk3328/Kconfig"
source "board/rockchip/rock64_rk3328/Kconfig"

endif
```

## board/frontrow/rosetta-rk3328/Kconfig
```kconfig
if TARGET_ROSETTA_RK3328

config SYS_BOARD
	default "rosetta_rk3328"

config SYS_VENDOR
	default "frontrow"

config SYS_CONFIG_NAME
	default "rosetta_rk3328"

config BOARD_SPECIFIC_OPTIONS # dummy
	def_bool y

endif
```

## board/rockchip/common/Kconfig
```kconfig
menu "RK Common Config"

config RM_RAMDISK_LOAD
	tristate "loader root from flash for linux"
	default n
endmenu
```

## board/rockchip/evb_rk3399/fit_spl_atf.its
```
/*
 * Simple U-boot uImage source file containing a single kernel and FDT blob
 */

/dts-v1/;

/ {
	description = "Simple image with single ATF bl31";
	#address-cells = <1>;

	images {
		uboot@1 {
			description = "U-Boot (64-bit)";
			data = /incbin/("u-boot-nodtb.bin");
			type = "standalone";
			arch = "arm64";
			compression = "none";
			load = <0x00200000>;
		};
		atf@1 {
			description = "ARM Trusted Firmware";
			data = /incbin/("./bl31.bin");
			type = "firmware";
			arch = "arm64";
			compression = "none";
			load = <0x000010000>;
			entry = <0x000010000>;
		};
		atf@2 {
			description = "ARM Trusted Firmware m0";
			data = /incbin/("./bl31_m0.bin");
			type = "firmware";
			arch = "arm64";
			compression = "none";
			load = <0xff8c0000>;
		};
		atf@3 {
			description = "ARM Trusted Firmware data";
			data = /incbin/("./bl31_data.bin");
			type = "firmware";
			arch = "arm64";
			compression = "none";
			load = <0xff8c1000>;
		};
		fdt@1 {
			description = "evb-rk3399 dtb";
			data = /incbin/("u-boot.dtb");
			type = "flat_dt";
			compression = "none";
		};
	};

	configurations {
		default = "conf@1";
		conf@1 {
			description = "RK3399 evb";
			firmware = "uboot@1";
			loadables = "atf@1","atf@2","atf@3";
			fdt = "fdt@1";
		};
	};
};
```

## board/rockchip/pinebook_pro_rk3399/Kconfig
```kconfig
if TARGET_PINEBOOK_PRO_RK3399

config SYS_BOARD
	default "pinebook_pro_rk3399"

config SYS_VENDOR
	default "rockchip"

config SYS_CONFIG_NAME
	default "pinebook_pro_rk3399"

config BOARD_SPECIFIC_OPTIONS # dummy
	def_bool y

endif
```

## board/rockchip/rk32xx/Kconfig
```kconfig
if ROCKCHIP_ARCH32

config SYS_BOARD
	default "rk32xx"

config SYS_VENDOR
	default "rockchip"


if PLAT_RK32XX

config SYS_CONFIG_NAME
	default "rk32plat"

endif

if PLAT_RK30XX

config SYS_CONFIG_NAME
	default "rk30plat"

endif

endif
```

## board/rockchip/rk33xx/Kconfig
```kconfig
if ROCKCHIP_ARCH64

config SYS_BOARD
	default "rk33xx"

config SYS_VENDOR
	default "rockchip"


if PLAT_RK33XX

config SYS_CONFIG_NAME
	default "rk33plat"

endif

endif
```

## board/rockchip/rock64_rk3328/Kconfig
```kconfig
if TARGET_ROCK64_RK3328

config SYS_BOARD
	default "rock64_rk3328"

config SYS_VENDOR
	default "rockchip"

config SYS_CONFIG_NAME
	default "rock64_rk3328"

config BOARD_SPECIFIC_OPTIONS # dummy
	def_bool y

endif
```

## board/rockchip/virtual_rk3288/Kconfig
```kconfig
if TARGET_VIRTUAL_RK3288

config SYS_BOARD
	default "virtual_rk3288"

config SYS_VENDOR
	default "rockchip"

config SYS_CONFIG_NAME
	default "virtual_rk3288"

config BOARD_SPECIFIC_OPTIONS # dummy
	def_bool y

endif
```
